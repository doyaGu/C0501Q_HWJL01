## sdk/project/test_rs485/Kconfig.win32
```kconfig
#
# For a description of the syntax of this configuration file,
# see Documentation/kbuild/kconfig-language.txt.
#

mainmenu "Project Configuration"

config TEST_CAPTURE
    bool
    default y
    select HAVE_LCD
    select HAVE_GRAPHICS
    select HAVE_VIDEO

config CMAKE_SOURCE_DIR
    string
    option env="CMAKE_SOURCE_DIR"

config DEF_CHIP_PKG_IT9079
    def_bool y

config RAM_INIT_SCRIPT
    default "IT9079A1_Initial_DDR2_Mem_tiling_pitch2048_360MHZ.scr"

config LCD_ENABLE
    def_bool y

config BACKLIGHT_ENABLE
    def_bool y

config BACKLIGHT_DUTY_CYCLES
    default "95, 92, 88, 82, 75, 65, 55, 40, 25, 5"

config BACKLIGHT_DEFAULT_DUTY_CYCLE
    default "5"

config LCD_HEIGHT
    default "480"

config LCD_INIT_SCRIPT
    default "IT9850_LCD_800_480_innolux_7inch_888.txt.in"

config VIDEO_ENABLE
    def_bool y

config I2C0_ENABLE
    def_bool y

config DEF_IIC0_GPIO_CONFIG_2
    def_bool y

config DEV_TEST
    def_bool n

config WIN32_SIMULATOR
    def_bool n

config CAPTURE_MODULE_ENABLE
    def_bool y

source "$CMAKE_SOURCE_DIR/sdk/Kconfig"

menu "LCD Test"

    choice
        prompt "Test App"
        default TEST_LCD_COLOR

    config TEST_LCD_COLOR
        bool "LCD_COLOR"

    config TEST_LCD_INTR
        bool "LCD_INTR"

    config TEST_LCDCONSOLE
        bool "LCDCONSOLE"

    config TEST_OSDCONSOLE
        bool "OSDCONSOLE"

    config TEST_BACKLIGHT
        bool "BACKLIGHT"

    config TEST_STNLCD
        bool "STNLCD"

    endchoice

endmenu
```

## sdk/project/test_timer/Kconfig
```kconfig
#
# For a description of the syntax of this configuration file,
# see Documentation/kbuild/kconfig-language.txt.
#

mainmenu "Project Configuration"

config PROJECT_MODULE_DEFINED
    bool
    default y
    select HAVE_LCD
    select HAVE_GRAPHICS
    select HAVE_AUDIO
    select HAVE_VIDEO
    
config DEF_CHIP_PKG_IT9856
    def_bool y
    
config RAM_INIT_SCRIPT
    default "IT9850A0_360MHz.scr"
    
config DBG_INIT_SCRIPT
	default "IT9850A0_400MHz.txt"
    
config UART1_ENABLE
    def_bool y    
    
config GPIO_UART1_TX
    default "4"
    
config LCD_ENABLE
    def_bool y

config LCD_WIDTH
    default "800"

config LCD_HEIGHT
    default "480"
    
config LCD_PITCH
    default "1600"
    
config LCD_INIT_SCRIPT
    default "IT9850_LCD_800_480_Allentech_7inch_565.txt.in"

config BACKLIGHT_ENABLE
    def_bool y

config BACKLIGHT_DUTY_CYCLES
    default "95, 92, 88, 82, 75, 65, 55, 40, 25, 5"

config GPIO_BACKLIGHT_PWM
     default "64"

config BACKLIGHT_DEFAULT_DUTY_CYCLE
    default "5"

config CMAKE_SOURCE_DIR
    string
    option env="CMAKE_SOURCE_DIR"
    
menu "TEST TIMER"

    choice
    prompt "TIMER TEST"
    default TIMER_BASIC_TEST
    help
        Test Timer.
    help_cht
        測試 Timer
    help_chs
        測試 Timer
        
    config TIMER_BASIC_TEST  
    bool "basic timer test"
    help
        basic timer test.
    help_cht
        timer 測試。
    help_chs
        timer 測試。
        
    config TIMER_TIMEOUT_TEST  
    bool "timeout test"
    help
        timeout test.
    help_cht
        timeout 測試。
    help_chs
        timeout 測試。        
        
    config TIMER_IRQ_TEST  
    bool "interrupt request test "
    help
        test interrupt request.
    help_cht
        測試IRQ (Interrupt Request)。
    help_chs
        測試IRQ (Interrupt Request)。 
        
    config TIMER_PWM_TEST  
    bool "pwm test "
    help
        test pwm(backlight module adjust luminance).
    help_cht
        測試PWM (背光模組調整亮度)。
    help_chs
        測試PWM (背光模組調整亮度)。         
        
        
    endchoice

endmenu       
    

source "$CMAKE_SOURCE_DIR/sdk/Kconfig"
```

## sdk/project/test_timer/Kconfig.win32
```kconfig
#
# For a description of the syntax of this configuration file,
# see Documentation/kbuild/kconfig-language.txt.
#

mainmenu "Project Configuration"

config PROJECT_MODULE_DEFINED
    bool
    default y
    select HAVE_LCD
    select HAVE_GRAPHICS
    select HAVE_AUDIO
    select HAVE_VIDEO

config CMAKE_SOURCE_DIR
    string
    option env="CMAKE_SOURCE_DIR"

source "$CMAKE_SOURCE_DIR/sdk/Kconfig"
```

## sdk/project/test_touch/Kconfig
```kconfig
#
# For a description of the syntax of this configuration file,
# see Documentation/kbuild/kconfig-language.txt.
#

mainmenu "Project Configuration"

config TEST_TOUCH
    bool
    default y
    select HAVE_LCD
    select HAVE_GRAPHICS
    #select HAVE_AUDIO
    #select HAVE_VIDEO

config CMAKE_SOURCE_DIR
	string
	option env="CMAKE_SOURCE_DIR"

config DEF_CHIP_PKG_IT9856
	def_bool y

config DEF_CHIP_REV_A0
    def_bool y  

config RAM_SIZE
    default "0x4000000"

config RAM_INIT_SCRIPT
    default "IT9850A0_360MHz.scr"

config DBG_INIT_SCRIPT
	default "IT9850A0_400MHz.txt"

config I2C0_ENABLE
    def_bool y

config I2C1_ENABLE
    def_bool y

config DEF_TOUCH_I2C1
    def_bool y

config TOUCH_ENABLE
	def_bool y

config TOUCH_MODULE
	default "ft5316"

config TOUCH_X_MAX_VALUE
	default "0x31F"

config TOUCH_Y_MAX_VALUE
	default "0x1DF"

config GPIO_TOUCH_INT
	default "38"

config GPIO_TOUCH_WAKE
	default "-1"

config UART1_ENABLE
    def_bool y

config GPIO_UART1_TX
    default "4"

config GPIO_UART1_RX
    default "-1"

config BUILD_TSLIB
	def_bool y

config BUILD_FAT
	def_bool y

config BUILD_SDL
	def_bool y

config USB0_ENABLE
	def_bool y

config MSC_ENABLE
	def_bool y

config FS_FAT
	def_bool y

config LCD_ENABLE
	def_bool y

config LCD_WIDTH
    default "800"

config LCD_HEIGHT
    default "480"

config LCD_INIT_SCRIPT
    default "IT9850_LCD_800_480_Allentech_7inch_565.txt.in"

config TASK_DRIVE_PROBE
	def_bool y

source "$CMAKE_SOURCE_DIR/sdk/Kconfig"
```

## sdk/project/test_touch/Kconfig.win32
```kconfig
#
# For a description of the syntax of this configuration file,
# see Documentation/kbuild/kconfig-language.txt.
#

mainmenu "Project Configuration"

config TEST_TOUCH
    bool
    default y
    select HAVE_LCD
    select HAVE_GRAPHICS
    #select HAVE_AUDIO
    #select HAVE_VIDEO

config CMAKE_SOURCE_DIR
	string
	option env="CMAKE_SOURCE_DIR"

config DEF_CHIP_PKG_IT9079
	def_bool y

config DCPS_ENABLE
    def_bool y

config I2C0_ENABLE
    def_bool y

config TOUCH_ENABLE
	def_bool y

config TOUCH_MODULE
	default "zt2083"

config TOUCH_X_MAX_VALUE
	default "0x31F"

config TOUCH_Y_MAX_VALUE
	default "0x1DF"

config GPIO_TOUCH_INT
	default "45"

config GPIO_TOUCH_WAKE
	default "-1"

config BUILD_TSLIB
	def_bool y

config BUILD_FAT
	def_bool y

config BUILD_SDL
	def_bool y

config SD0_ENABLE
    def_bool y

config SD0_STATIC
    def_bool y

config FS_FAT
	def_bool y

config LCD_ENABLE
	def_bool y

config LCD_WIDTH
    default "800"

config LCD_HEIGHT
    default "480"

config LCD_INIT_SCRIPT
    default "IT9850_LCD_800_480_innolux_7inch_565.txt.in"

config TASK_DRIVE_PROBE
	def_bool y

source "$CMAKE_SOURCE_DIR/sdk/Kconfig"
```

## sdk/project/test_upgrade/Kconfig
```kconfig
#
# For a description of the syntax of this configuration file,
# see Documentation/kbuild/kconfig-language.txt.
#

mainmenu "Project Configuration"

config TEST_UPGRADE
    bool
    default y
    #select HAVE_LCD
    #select HAVE_GRAPHICS
    #select HAVE_AUDIO
    #select HAVE_VIDEO

config CMAKE_SOURCE_DIR
	string
	option env="CMAKE_SOURCE_DIR"

config DEF_CHIP_PKG_IT9852
    def_bool y

config DEF_CHIP_REV_A0
    def_bool y  

config RAM_SIZE
    default "0x1000000"

config RAM_INIT_SCRIPT
    default "IT9850A0_360MHz.scr"
config NOR_ENABLE
    def_bool y

config NOR_CACHE_SIZE
    default "0x100000"

config NOR_RESERVED_SIZE
    default "0x300000"

config NOR_PARTITION0
    def_bool y

config NOR_PARTITION0_SIZE
    default "0xA00000"

config NOR_PARTITION1
    def_bool y

config FS_FAT
    def_bool y
config UART1_ENABLE
    def_bool y

config GPIO_UART1_TX
    default "4"

config GPIO_UART1_RX
    default "-1"

config SPI0_MOSI_GPIO
    default "18"

config SPI0_MISO_GPIO
    default "19"

config SPI0_CLOCK_GPIO
    default "20"

config SPI0_CHIP_SEL_GPIO
    default "14"
config DEF_DBG_UART1
    def_bool y

config DBG_INIT_SCRIPT
    default "IT9850A0_400MHz.txt"

config BUILD_UPGRADE
	def_bool y

source "$CMAKE_SOURCE_DIR/sdk/Kconfig"

menu "Upgrade Test"

choice
	prompt "Test App"
	default TEST_CHECKCRC

config TEST_CHECKCRC
	bool "CHECKCRC"

endchoice

endmenu
```

## sdk/project/test_upgrade/Kconfig.win32
```kconfig
#
# For a description of the syntax of this configuration file,
# see Documentation/kbuild/kconfig-language.txt.
#

mainmenu "Project Configuration"

config TEST_UPGRADE
    bool
    default y
    #select HAVE_LCD
    #select HAVE_GRAPHICS
    #select HAVE_AUDIO
    #select HAVE_VIDEO

config CMAKE_SOURCE_DIR
	string
	option env="CMAKE_SOURCE_DIR"

config BUILD_UPGRADE
	def_bool y

source "$CMAKE_SOURCE_DIR/sdk/Kconfig"

menu "Upgrade Test"

choice
	prompt "Test App"
	default TEST_CHECKCRC

config TEST_CHECKCRC
	bool "CHECKCRC"

endchoice

endmenu
```

## sdk/project/test_video/Kconfig
```kconfig
#
# For a description of the syntax of this configuration file,
# see Documentation/kbuild/kconfig-language.txt.
#

mainmenu "Project Configuration"

config TEST_VIDEO
    bool
    default y
    select HAVE_LCD
    select HAVE_GRAPHICS
    select HAVE_VIDEO
    select HAVE_AUDIO

config CMAKE_SOURCE_DIR
    string
    option env="CMAKE_SOURCE_DIR"

config DEF_CHIP_PKG_IT9856
    def_bool y

config DEF_CHIP_REV_A0
    def_bool y  

config RAM_SIZE
    default "0x4000000"

config RAM_INIT_SCRIPT
    default "IT9850A0_400MHz_tiling_pitch2048.scr"

config LCD_ENABLE
    def_bool y

config LCD_WIDTH
    default "800"

config LCD_HEIGHT
    default "480"
    
config LCD_PITCH
    default "1600"

config LCD_INIT_SCRIPT
    default "IT9850_LCD_800_480_Allentech_7inch_565.txt.in"

config BACKLIGHT_ENABLE
    def_bool y

config BACKLIGHT_DUTY_CYCLES
    default "95, 92, 88, 82, 75, 65, 55, 40, 25, 5"

config GPIO_BACKLIGHT_PWM
     default "64"

config BACKLIGHT_DEFAULT_DUTY_CYCLE
    default "5"
    
config CMDQ_ENABLE
    def_bool y

config M2D_ENABLE
    def_bool y

config JPEG_HW_ENABLE
    def_bool y
	
config UART1_ENABLE
    def_bool y

config GPIO_UART1_TX
    default "4"

config GPIO_UART1_RX
    default "-1"

config DEF_DBG_UART1
    def_bool y

config DBG_INIT_SCRIPT
    default "IT9850A0_400MHz.txt"

config BUILD_FFMPEG
    def_bool y

config VIDEO_ENABLE
    def_bool y

config STC_ENABLE
    def_bool y

config FS_FAT
    def_bool y
    
config ITU_UCL_ENABLE
    def_bool y
    
config BUILD_INIPARSER
    def_bool y
    
config BUILD_ITU
    def_bool y

config BUILD_SDL
    def_bool y

config USB0_ENABLE
    def_bool y

config MSC_ENABLE
    def_bool y

config TASK_DRIVE_PROBE
    def_bool y

config I2S_ENABLE
    def_bool y

config I2S_OUTPUT_PIN_ENABLE
    def_bool n

config I2S_SPDIF_ENABLE
    def_bool n

config RECORD_VIDEO
    def_bool y

source "$CMAKE_SOURCE_DIR/sdk/Kconfig"

menu "Test H.264 / Mjpeg"

    choice
        prompt "Test H.264 / Mjpeg"
        default TEST_CONTAINER

    config TEST_ELEMENTARY
        bool "ElementaryStream format (h264, 264, etc)"

    config TEST_CONTAINER
        bool "Container format (MKV, MP4, etc)"
        
    config TEST_MJPEG
        bool "Container format (AVI)"
        
    #config TEST_GOLDEN
    #    bool "Golden bitstream file format (bmp)"

    endchoice

endmenu
```

## sdk/project/test_video/Kconfig.win32_9079
```kconfig
#
# For a description of the syntax of this configuration file,
# see Documentation/kbuild/kconfig-language.txt.
#

mainmenu "Project Configuration"

config TEST_VIDEO
    bool
    default y
    select HAVE_LCD
    select HAVE_VIDEO
    select HAVE_AUDIO

config CMAKE_SOURCE_DIR
    string
    option env="CMAKE_SOURCE_DIR"

config DEF_CHIP_PKG_IT9079
    def_bool y

config RAM_INIT_SCRIPT
    default "IT9079A1_Initial_DDR2_Mem_tiling_pitch2048_360MHZ.scr"

config LCD_ENABLE
    def_bool y

config LCD_WIDTH
    default "800"

config LCD_HEIGHT
    default "480"

config LCD_INIT_SCRIPT
    default "lcd_800_480_innolux_7inch_888.txt.in"

config BACKLIGHT_ENABLE
    def_bool y

config BACKLIGHT_DUTY_CYCLES
    default "95, 92, 88, 82, 75, 65, 55, 40, 25, 5"

config BACKLIGHT_DEFAULT_DUTY_CYCLE
    default "5"

config BUILD_FFMPEG
    def_bool y

config VIDEO_ENABLE
    def_bool y

config WIN32_SIMULATOR
    def_bool n

config FS_FAT
    def_bool y

source "$CMAKE_SOURCE_DIR/sdk/Kconfig"

menu "Test H.264"

    choice
        prompt "Test H.264"
        default TEST_CONTAINER

    config TEST_ELEMENTARY
        bool "ElementaryStream format (h264, 264, etc)"

    config TEST_CONTAINER
        bool "Container format (MKV, MP4, etc)"

    #config TEST_GOLDEN
    #    bool "Golden bitstream file format (bmp)"

    endchoice

endmenu
```

## sdk/sdk/driver/Kconfig
```kconfig
#
# For a description of the syntax of this configuration file,
# see Documentation/kbuild/kconfig-language.txt.
#
source "$CMAKE_SOURCE_DIR/sdk/driver/ith/Kconfig"
source "$CMAKE_SOURCE_DIR/sdk/driver/itp/Kconfig"
```

## sdk/sdk/driver/ith/Kconfig
```kconfig
#
# For a description of the syntax of this configuration file,
# see Documentation/kbuild/kconfig-language.txt.
#

menu "ith"

config ITH_ERR
    bool "Error Log"
    default y
    help
        Output error log.
    help_cht
        輸出錯誤訊息。
    help_chs
        输出错误讯息。

config ITH_WARN
    bool "Warning Log"
    default y
    help
        Output warning log.
    help_cht
        輸出警告訊息。
    help_chs
        输出警告讯息。

config ITH_INFO
    bool "Information Log"
    default y
    help
        Output information log.
    help_cht
        輸出資訊訊息。
    help_chs
        输出资讯讯息。

config ITH_DBG
    bool "Debug Log"
    default n
    help
        Output debug log.
    help_cht
        輸出除錯訊息。
    help_chs
        输出侦错讯息。

config ITH_FPGA
    bool "FPGA Simulation"
    default n
    help
        Build for FPGA Simulation. (Only used at FPGA verification)
    help_cht
        開啟 FPGA 模擬模式功能。(此功能只在 FPGA 驗證時使用）
    help_chs
        开启 FPGA 模拟模式功能。(此功能只在 FPGA 验證时使用）

config ITH_FPGA_CLK_CPU
    string "FPGA CPU clock"
    depends on ITH_FPGA
    default "40000000"
    help
        FPGA CPU clock
    help_cht
        在 FPGA 環境下 CPU 的速度設定。
    help_chs
        在 FPGA 环境下 CPU 的速度设定。

config ITH_FPGA_CLK_MEM
    string "FPGA memory clock"
    depends on ITH_FPGA
    default "36000000"
    help
        FPGA memory clock
    help_cht
        在 FPGA 環境下記憶體的速度設定。
    help_chs
        在 FPGA 环境下记忆体的速度设定。

config ITH_FPGA_CLK_BUS
    string "FPGA bus clock"
    depends on ITH_FPGA
    default "27000000"
    help
        FPGA bus clock
    help_cht
        在 FPGA 環境下 APB bus 的速度設定。
    help_chs
        在 FPGA 环境下 APB bus 的速度设定。

endmenu
```

## sdk/sdk/driver/itp/Kconfig
```kconfig
#
# For a description of the syntax of this configuration file,
# see Documentation/kbuild/kconfig-language.txt.
#

menu "itp"

config ITP_ERR
    bool "Error Log"
    default y
    help
        Output error log. RD internal use only.
    help_cht
        輸出錯誤訊息。
    help_chs
        输出错误讯息。

config ITP_WARN
    bool "Warning Log"
    default y
    help
        Output warning log. RD internal use only.
    help_cht
        輸出警告訊息。
    help_chs
        输出警告讯息。

config ITP_INFO
    bool "Information Log"
    default y
    help
        Output information log. RD internal use only.
    help_cht
        輸出資訊訊息。
    help_chs
        输出资讯讯息。

config ITP_DBG
    bool "Debug Log"
    default n
    help
        Output debug log. RD internal use only.
    help_cht
        輸出除錯訊息。
    help_chs
        输出侦错讯息。

endmenu
```
