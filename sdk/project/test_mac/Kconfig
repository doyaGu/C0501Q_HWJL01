## sdk/project/test_mac/Kconfig
```kconfig
#
# For a description of the syntax of this configuration file,
# see Documentation/kbuild/kconfig-language.txt.
#

mainmenu "Project Configuration"

config CMAKE_SOURCE_DIR
	string
	option env="CMAKE_SOURCE_DIR"

config DEF_CHIP_PKG_IT9856
	def_bool y
	
config MEMDBG_ENABLE
	def_bool n

config ROM_COMPRESS
	def_bool n

config NET_ENABLE
	def_bool y

config NET_ETHERNET
	def_bool y

config DEF_NET_RTL8304MB
	def_bool y

config NET_ETHERNET_LINK_INTR
	default y

config GPIO_ETHERNET
	default "34, 35, 36, 90, 91, 92, 93, 94, 95, 96"

config GPIO_ETHERNET_LINK
	default "33"

config DBG_INIT_SCRIPT
    default "IT9850A0_400MHZ.txt"

source "$CMAKE_SOURCE_DIR/sdk/Kconfig"


menu "MAC Test"

choice
	prompt "Test App"
	default TEST_LB_1

config TEST_LB_1
	bool "Loopback test APP1"
	help
	    Wait each packet complete.

config TEST_LB_2
	bool "Loopback test APP2"
	help
	    Don't wait packet complete.

config TEST_LWIP
	bool "Test by ping"
	help
	    Ping by another PC and our IP is 192.168.1.1

endchoice


config ETH_MODE
    string "Loopback mode"
    depends on (TEST_LB_1 || TEST_LB_2)
    default "2"
    help
        ITE_ETH_MAC_LB		 = 2
        ITE_ETH_PCS_LB_10	 = 3
        ITE_ETH_PCS_LB_100	 = 4
        ITE_ETH_MDI_LB_10	 = 5
        ITE_ETH_MDI_LB_100	 = 6

endmenu
```

## sdk/project/test_mac/Kconfig.phy.9079
```kconfig
#
# For a description of the syntax of this configuration file,
# see Documentation/kbuild/kconfig-language.txt.
#

mainmenu "Project Configuration"

config CMAKE_SOURCE_DIR
	string
	option env="CMAKE_SOURCE_DIR"

config DEF_CHIP_PKG_IT9079
	def_bool y
	
config MEMDBG_ENABLE
	def_bool n

config ROM_COMPRESS
	def_bool n

config NET_ENABLE
	def_bool y

config NET_ETHERNET
	def_bool y

config NET_ETHERNET_PHY_ADDR
	default "4"

config NET_ETHERNET_LINK_INTR
	default y

config GPIO_ETHERNET
	default "34, 35, 36, 37, 38, 39, 40, 41, 42, 43"

config GPIO_ETHERNET_LINK
	default "44"

config DBG_INIT_SCRIPT
    default "IT9079A1_Initial_DDR2_Mem_tiling_pitch2048_266MHZ.txt"

source "$CMAKE_SOURCE_DIR/sdk/Kconfig"


menu "MAC Test"

choice
	prompt "Test App"
	default TEST_WINDOW

config TEST_WINDOW
	bool "Find window test APP"
	help
	    Scan clock and delay.

config TEST_LB_1
	bool "Loopback test APP1"
	help
	    Wait each packet complete.

config TEST_LB_2
	bool "Loopback test APP2"
	help
	    Don't wait packet complete.

config TEST_LWIP
	bool "Test by ping"
	help
	    Ping by another PC and our IP is 192.168.1.1

endchoice


config ETH_MODE
    string "Loopback mode"
    depends on (TEST_LB_1 || TEST_LB_2 || TEST_WINDOW)
    default "4"
    help
        ITE_ETH_MAC_LB		 = 2
        ITE_ETH_PCS_LB_10	 = 3
        ITE_ETH_PCS_LB_100	 = 4
        ITE_ETH_MDI_LB_10	 = 5
        ITE_ETH_MDI_LB_100	 = 6

endmenu
```

## sdk/project/test_mac/Kconfig.phy.outdoor.9910
```kconfig
#
# For a description of the syntax of this configuration file,
# see Documentation/kbuild/kconfig-language.txt.
#

mainmenu "Project Configuration"

config CMAKE_SOURCE_DIR
	string
	option env="CMAKE_SOURCE_DIR"
	
config DEF_CPU_SM32
	def_bool y
	
config DEF_CHIP_PKG_IT9910
	def_bool y
	
config MEMDBG_ENABLE
	def_bool n

config ROM_COMPRESS
	def_bool n

config NET_ENABLE
	def_bool y

config NET_ETHERNET
	def_bool y

config NET_ETHERNET_PHY_ADDR
	default "0"

config NET_ETHERNET_LINK_INTR
	default y

config GPIO_ETHERNET
	default "13, 14, 27, 28, 42, 43, 44, 45, 46, 47"

config GPIO_ETHERNET_LINK
	default "4"

config SPI0_MOSI_GPIO
    default "9"
    
config SPI0_MISO_GPIO
    default "10"
    
config SPI0_CLOCK_GPIO
    default "11"
    
config SPI0_CHIP_SEL_GPIO
    default "7"

config DBG_INIT_SCRIPT
    default "IT9919_A1_Initial_DDR2_Mem_notiling_380MHZ.txt"

source "$CMAKE_SOURCE_DIR/sdk/Kconfig"


menu "MAC Test"

choice
	prompt "Test App"
	default TEST_WINDOW

config TEST_WINDOW
	bool "Find window test APP"
	help
	    Scan clock and delay.

config TEST_LB_1
	bool "Loopback test APP1"
	help
	    Wait each packet complete.

config TEST_LB_2
	bool "Loopback test APP2"
	help
	    Don't wait packet complete.

config TEST_LWIP
	bool "Test by ping"
	help
	    Ping by another PC and our IP is 192.168.1.1

endchoice


config ETH_MODE
    string "Loopback mode"
    depends on (TEST_LB_1 || TEST_LB_2 || TEST_WINDOW)
    default "4"
    help
        ITE_ETH_MAC_LB		 = 2
        ITE_ETH_PCS_LB_10	 = 3
        ITE_ETH_PCS_LB_100	 = 4
        ITE_ETH_MDI_LB_10	 = 6
        ITE_ETH_MDI_LB_100	 = 7

endmenu
```

## sdk/project/test_mac/Kconfig.phy8201.9920
```kconfig
#
# For a description of the syntax of this configuration file,
# see Documentation/kbuild/kconfig-language.txt.
#

mainmenu "Project Configuration"

config CMAKE_SOURCE_DIR
	string
	option env="CMAKE_SOURCE_DIR"

config DEF_CHIP_PKG_IT9920
	def_bool y
	
config MEMDBG_ENABLE
	def_bool n

config ROM_COMPRESS
	def_bool n

config NET_ENABLE
	def_bool y

config NET_ETHERNET
	def_bool y

config DEF_NET_RTL8201FL
	def_bool y

config NET_ETHERNET_PHY_ADDR
	default "0"

config NET_ETHERNET_LINK_INTR
	default n

config GPIO_ETHERNET
	default "25, 26, 27, 28, 29, 30, 31, 32, 33, 34"

config GPIO_ETHERNET_LINK
	default "39"

config DBG_INIT_SCRIPT
    default "IT9850A0_400MHZ.txt"

source "$CMAKE_SOURCE_DIR/sdk/Kconfig"


menu "MAC Test"

choice
	prompt "Test App"
	default TEST_WINDOW

config TEST_WINDOW
	bool "Find window test APP"
	help
	    Scan clock and delay.

config TEST_LB_1
	bool "Loopback test APP1"
	help
	    Wait each packet complete.

config TEST_LB_2
	bool "Loopback test APP2"
	help
	    Don't wait packet complete.

config TEST_LWIP
	bool "Test by ping"
	help
	    Ping by another PC and our IP is 192.168.1.1

config TEST_MULTICAST
	bool "Multicast function test"
	depends on (!CHIP_PKG_IT9079 && !CHIP_PKG_IT9910 && !CHIP_PKG_IT9852 && !CHIP_PKG_IT9854 && !CHIP_PKG_IT9856)
	help
	    Test multicast feature for gmac.

config TEST_JUMBO
	bool "Fumbo frame test"
	depends on (!CHIP_PKG_IT9079 && !CHIP_PKG_IT9910 && !CHIP_PKG_IT9852 && !CHIP_PKG_IT9854 && !CHIP_PKG_IT9856)
	help
	    Test jumbo frame for gmac.


endchoice


config ETH_MODE
    string "Loopback mode"
    depends on (!TEST_LWIP)
    default "4"
    help
				ITE_ETH_MAC_LB         = 2
				ITE_ETH_PCS_LB_10      = 3
				ITE_ETH_PCS_LB_100     = 4
				ITE_ETH_MDI_LB_10      = 6
				ITE_ETH_MDI_LB_100     = 7
				ITE_ETH_MAC_LB_1000    = 9

endmenu
```

## sdk/project/test_mac/Kconfig.rtl8304mb.9079
```kconfig
#
# For a description of the syntax of this configuration file,
# see Documentation/kbuild/kconfig-language.txt.
#

mainmenu "Project Configuration"

config CMAKE_SOURCE_DIR
	string
	option env="CMAKE_SOURCE_DIR"

config DEF_CHIP_PKG_IT9079
	def_bool y
	
config MEMDBG_ENABLE
	def_bool n

config ROM_COMPRESS
	def_bool n

config NET_ENABLE
	def_bool y

config NET_ETHERNET
	def_bool y

config DEF_NET_RTL8304MB
	def_bool y

config NET_ETHERNET_LINK_INTR
	default y

config GPIO_ETHERNET
	default "34, 35, 36, 37, 38, 39, 40, 41, 42, 43"

config GPIO_ETHERNET_LINK
	default "44"

config DBG_INIT_SCRIPT
    default "IT9079A1_Initial_DDR2_Mem_tiling_pitch2048_266MHZ.txt"

source "$CMAKE_SOURCE_DIR/sdk/Kconfig"
```

## sdk/project/test_peripheral/Kconfig
```kconfig
#
# For a description of the syntax of this configuration file,
# see Documentation/kbuild/kconfig-language.txt.
#

mainmenu "Project Configuration"

config TEST_PERIPHERAL
    bool
    default y
    #select HAVE_LCD
    #select HAVE_GRAPHICS
    #select HAVE_AUDIO
    #select HAVE_VIDEO

config CMAKE_SOURCE_DIR
	string
	option env="CMAKE_SOURCE_DIR"

config DEF_CHIP_PKG_IT9856
	def_bool y

config RAM_INIT_SCRIPT
    default "IT9850A0_360MHz.scr"

config DBG_INIT_SCRIPT
	default "IT9850A0_400MHz.txt"

config I2C0_ENABLE
    default y

config KEYPAD_ENABLE
	def_bool y

config KEYPAD_MODULE
    default "itp_keypad_it7236.c"

config KEYPAD_MAPPING_TABLE
    default "keypad_doorbell_indoor.inc"

config TOUCH_KEYPAD_SET_KEY_NUMBER_ENABLE
    def_bool y

config TOUCH_KEY_NUM
    default "5"

config GPIO_KEYPAD
    default "23"

config TOUCH_KEY_USE_I2C
    def_bool y
    
config UART1_ENABLE
    def_bool y

config GPIO_UART1_TX
    default "5"

config GPIO_UART1_RX
    default "-1"

config GPIO_LED
    default "4"

source "$CMAKE_SOURCE_DIR/sdk/Kconfig"

menu "Peripheral Test"

choice
	prompt "Test App"
	default TEST_KEYPAD

config TEST_KEYPAD
	bool "Keypad"
	depends on KEYPAD_ENABLE

config TEST_IR
	bool "IR"
	depends on IR_ENABLE

config TEST_LED
	bool "LED"
	depends on LED_ENABLE

config TEST_RTC
	bool "RTC"
	depends on RTC_ENABLE

endchoice

endmenu
```

## sdk/project/test_posixapi/Kconfig
```kconfig
#
# For a description of the syntax of this configuration file,
# see Documentation/kbuild/kconfig-language.txt.
#

mainmenu "Project Configuration"

config TEST_POSIXAPI
    bool
    default y
    #select HAVE_LCD
    #select HAVE_GRAPHICS
    #select HAVE_AUDIO
    #select HAVE_VIDEO

config CMAKE_SOURCE_DIR
	string
	option env="CMAKE_SOURCE_DIR"

config DEF_CHIP_PKG_IT9852
    def_bool y

config DEF_CHIP_REV_A0
    def_bool y  

config RAM_SIZE
    default "0x1000000"

config RAM_INIT_SCRIPT
    default "IT9850A0_400MHz.scr"

config USB0_ENABLE
    def_bool y

config MSC_ENABLE
    def_bool y

config FS_FAT
    def_bool y
    
config RTC_ENABLE
    def_bool y    
    
config UART1_ENABLE
    def_bool y

config GPIO_UART1_TX
    default "4"

config GPIO_UART1_RX
    default "-1"

config TASK_DRIVE_PROBE
    def_bool y

config DEF_DBG_UART1
    def_bool y

config DBG_INIT_SCRIPT
    default "IT9850A0_400MHz.txt"

source "$CMAKE_SOURCE_DIR/sdk/Kconfig"


menu "POSIX API Test"

	choice
	
 		prompt "SYSTEM_TEST"
		default TEST_STDIO

	config TEST_STDIO
		bool "Stdio"

	config TEST_DIRENT
		bool "Dirent"
	
	config TEST_SEMAPHORE
    	bool "Semaphore"

	config TEST_STDLIB
    	bool "Stdlib"
    
	config TEST_SYSTIME
    	bool "Sys-time"
    
	config TEST_SYSTIMES
		bool "Sys-times"
	
	config TEST_SYSSTATVFS
    	bool "Sys-statvfs"

	config TEST_SYSSTAT
    	bool "Sys-stat"

	config TEST_UNISTD
    	bool "Unistd"

	config TEST_MALLOC
    	bool "Malloc"

	config TEST_SCHED
    	bool "Sched"

	config TEST_TIME
    	bool "Time"

	config TEST_MQUEUE
    	bool "Mqueue"
    
    config TEST_PTHREAD_ATTR
      	bool "Pthread_attr"

    config TEST_PTHREAD_COND
      	bool "Pthread_cond"

    config TEST_PTHREAD_KEY
    	bool "Pthread_key"

	config TEST_PTHREAD_MUTEX
    	bool "Pthread_mutex"

	config TEST_PTHREAD_OTHERS
    	bool "Pthread_Others"
	
	endchoice

endmenu
```

## sdk/project/test_posixapi/Kconfig.win32
```kconfig
#
# For a description of the syntax of this configuration file,
# see Documentation/kbuild/kconfig-language.txt.
#

mainmenu "Project Configuration"

config TEST_POSIXAPI
    bool
    default y
    #select HAVE_LCD
    #select HAVE_GRAPHICS
    #select HAVE_AUDIO
    #select HAVE_VIDEO

config CMAKE_SOURCE_DIR
	string
	option env="CMAKE_SOURCE_DIR"

config WIN32_SIMULATOR
    def_bool y

source "$CMAKE_SOURCE_DIR/sdk/Kconfig"


menu "POSIX API Test"

	choice
	
 		prompt "SYSTEM_TEST"
		default TEST_STDIO

	config TEST_STDIO
		bool "Stdio"

	config TEST_DIRENT
		bool "Dirent"
	
	config TEST_SEMAPHORE
    	bool "Semaphore"

	config TEST_STDLIB
    	bool "Stdlib"
    
	config TEST_SYSTIME
    	bool "Sys-time"
    
	config TEST_SYSTIMES
		bool "Sys-times"
	
	config TEST_SYSSTATVFS
    	bool "Sys-statvfs"

	config TEST_SYSSTAT
    	bool "Sys-stat"

	config TEST_UNISTD
    	bool "Unistd"

	config TEST_MALLOC
    	bool "Malloc"

	config TEST_SCHED
    	bool "Sched"

	config TEST_TIME
    	bool "Time"

	config TEST_MQUEUE
    	bool "Mqueue"
    
    config TEST_PTHREAD_ATTR
      	bool "Pthread_attr"

    config TEST_PTHREAD_COND
      	bool "Pthread_cond"

    config TEST_PTHREAD_KEY
    	bool "Pthread_key"

	config TEST_PTHREAD_MUTEX
    	bool "Pthread_mutex"

	config TEST_PTHREAD_OTHERS
    	bool "Pthread_Others"
	
	endchoice

endmenu
```

## sdk/project/test_pthread/Kconfig
```kconfig
#
# For a description of the syntax of this configuration file,
# see Documentation/kbuild/kconfig-language.txt.
#

mainmenu "Project Configuration"

config TEST_PTHREAD
    bool
    default y
    #select HAVE_LCD
    #select HAVE_GRAPHICS
    #select HAVE_AUDIO
    #select HAVE_VIDEO

config CMAKE_SOURCE_DIR
	string
	option env="CMAKE_SOURCE_DIR"

config DEF_CHIP_PKG_IT9852
    def_bool y

config DEF_CHIP_REV_A0
    def_bool y  

config RAM_SIZE
    default "0x1000000"

config RAM_INIT_SCRIPT
    default "IT9850A0_400MHz.scr"

config UART1_ENABLE
    def_bool y

config GPIO_UART1_TX
    default "4"

config GPIO_UART1_RX
    default "-1"

config DEF_DBG_UART1
    def_bool y

config DBG_INIT_SCRIPT
    default "IT9850A0_400MHz.txt"

source "$CMAKE_SOURCE_DIR/sdk/Kconfig"
```

## sdk/project/test_pthread/Kconfig.win32
```kconfig
#
# For a description of the syntax of this configuration file,
# see Documentation/kbuild/kconfig-language.txt.
#

mainmenu "Project Configuration"

config TEST_PTHREAD
    bool
    default y
    #select HAVE_LCD
    #select HAVE_GRAPHICS
    #select HAVE_AUDIO
    #select HAVE_VIDEO

config WIN32_SIMULATOR
    def_bool y

config CMAKE_SOURCE_DIR
    string
    option env="CMAKE_SOURCE_DIR"

source "$CMAKE_SOURCE_DIR/sdk/Kconfig"
```

## sdk/project/test_qrencode/Kconfig.win32
```kconfig
#
# For a description of the syntax of this configuration file,
# see Documentation/kbuild/kconfig-language.txt.
#

mainmenu "Project Configuration"

config TEST_QRENCODE
    bool
    default y
    select HAVE_LCD
    select HAVE_GRAPHICS
    select HAVE_AUDIO
    select HAVE_VIDEO

config CMAKE_SOURCE_DIR
	string
	option env="CMAKE_SOURCE_DIR"

config LCD_ENABLE
    def_bool y

config I2S_ENABLE
    def_bool y

config I2S_SPDIF_ENABLE
    def_bool n

config AUDIO_ENABLE
    def_bool y

config VIDEO_ENABLE
    def_bool y

config FFMPEG_H264_SW
    def_bool y

config ITU_UCL_ENABLE
    def_bool y

config WIN32_SIMULATOR
    def_bool y

config ITU_FT_CACHE_ENABLE
    def_bool y

config BUILD_AUDIO_MGR
    def_bool y

config BUILD_ITU
    def_bool y

config BUILD_SDL
    def_bool y

config BUILD_QRENCODE
    def_bool y
	

	
config CMAKE_SOURCE_DIR
    string
    option env="CMAKE_SOURCE_DIR"

source "$CMAKE_SOURCE_DIR/sdk/Kconfig"
```

## sdk/project/test_rs485/Kconfig
```kconfig
#
# For a description of the syntax of this configuration file,
# see Documentation/kbuild/kconfig-language.txt.
#

mainmenu "Project Configuration"

config TEST_RS485
    bool
    default y

config CMAKE_SOURCE_DIR
    string
    option env="CMAKE_SOURCE_DIR"

config DEF_CHIP_PKG_IT9856
    def_bool y

config DEF_CHIP_REV_A0
    def_bool y  

config RAM_SIZE
    default "0x4000000"

config RAM_INIT_SCRIPT
    default "IT9850A0_400MHz_tiling_pitch2048.scr"

config LCD_ENABLE
    def_bool y

config LCD_WIDTH
    default "800"

config LCD_HEIGHT
    default "480"
    
config LCD_PITCH
    default "1600"

config LCD_INIT_SCRIPT
    default "IT9850_LCD_800_480_Allentech_7inch_565.txt.in"

    
config UART1_ENABLE
    def_bool y

config GPIO_UART1_TX
    default "4"

config GPIO_UART1_RX
    default "-1"

config DEF_DBG_UART1
    def_bool y

config DBG_INIT_SCRIPT
    default "IT9850A0_400MHz.txt"

config RS485_0_ENABLE
    def_bool y
    
config GPIO_RS485_0_TX
    default "37"

config GPIO_RS485_0_TX_ENABLE
    default "97"
    
config GPIO_RS485_0_RX
    default "96"
    
config RTC_ENABLE
    def_bool y
    
source "$CMAKE_SOURCE_DIR/sdk/Kconfig"
```
