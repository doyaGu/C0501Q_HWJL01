## sdk/sdk/driver/usb/gadget/Kconfig
```kconfig
#
# For a description of the syntax of this configuration file,
# see Documentation/kbuild/kconfig-language.txt.
#

choice
    prompt "USB Device module"
    depends on USB_DEVICE
    default USB_DEVICE_USB0 if DEF_USB_DEVICE_USB0
    default USB_DEVICE_USB1 if DEF_USB_DEVICE_USB1
    default USB_DEVICE_USB0

config USB_DEVICE_USB0
    bool "use USB0 module"
    depends on USB0_ENABLE
    help
        use USB0 module
    help_cht
        使用 USB0 的設備端功能。
    help_chs
        使用 USB0 的设备端功能。

config USB_DEVICE_USB1
    bool "use USB1 module"
    depends on USB1_ENABLE
    help
        use USB1 module
    help_cht
        使用 USB1 的設備端功能。
    help_chs
        使用 USB1 的设备端功能。

endchoice

#
# USB Gadget Drivers
#
choice
    bool "USB Gadget Drivers"
    depends on USB_DEVICE
    default USBD_FILE_STORAGE

config USBD_FILE_STORAGE
    bool "usb mass storage"
    depends on USB_DEVICE
    help
        The File Storage Gadget acts as a USB Mass Storage disk drive.
    help_cht
        設備端功能為大容量儲存設備。
    help_chs
        设备端功能为大容量储存设备。

config USBD_IDB
   bool "iTE Development Bridge"
   depends on USBD_FILE_STORAGE
   default n
   help
        Other gadget driver.

endchoice


config USB_VENDOR_ID
    string "Vendor ID"
    depends on USB_DEVICE
    default "0x048D"
    help
        Vendor ID (assigned by the USB-IF).
    help_cht
        廠商識別碼。
    help_chs
        厂商标识符。

config USB_PRODUCT_ID
    string "Product ID"
    depends on USB_DEVICE
    default "0x9070"
    help
        Product ID (assigned by the manufacturer).
    help_cht
        產品識別碼。
    help_chs
        产品标识符。

config USBD_STR_MANUFACTURER
    string "Manufacturer String"
    depends on USB_DEVICE
    default "ITE Tech."
    help
        String descriptor describing manufacturer.
    help_cht
        製造商名稱字串。
    help_chs
        制造商名称字符串。

config USBD_STR_PRODUCT
    string "Product String"
    depends on USB_DEVICE
    default "Castor3"
    help
        String descriptor describing product.
    help_cht
        產品名稱字串。
    help_chs
        产品名称字符串。

config USBD_STR_SERIAL_NUMBER
    string
    prompt "Serial Number String" if DEV_DEVELOP
    depends on USB_DEVICE
    default "907012344321"
    help
        String descriptor describing the device's serial number. Need at least 12 uppercase hexadecimal characters, with a maximum of 126.
    help_cht
        序號指標。至少12個大寫16進制字符，最多126個。
    help_chs
        序号指标。至少12个大写16进制字符，最多126个。

config USB_DEVICE_DISKS
    string "USB Device Disks"
    depends on USB_DEVICE
    depends on USBD_FILE_STORAGE
    default "0, 1"
    help
        USB Device Disk Numbers. The maximum count is 4

        SD0       = 0,
        SD1       = 1,
        NAND      = 5,
        NOR       = 6,
        USB0 MSC0 = 7,
        USB0 MSC1 = 8,
        USB0 MSC2 = 9,
        USB0 MSC3 = 10,
        USB1 MSC0 = 15,
        USB1 MSC1 = 16,
        USB1 MSC2 = 17,
        USB1 MSC3 = 18,
        RAM Disk  = 23   => This is just for test only! It shall only has one disk if you choose this ram disk.
    help_cht
        指定磁碟號碼。最多可指定4個。可設定的磁碟號碼：

        SD0       = 0,
        SD1       = 1,
        NAND      = 5,
        NOR       = 6,
        USB0 MSC0 = 7,
        USB0 MSC1 = 8,
        USB0 MSC2 = 9,
        USB0 MSC3 = 10,
        USB1 MSC0 = 15,
        USB1 MSC1 = 16,
        USB1 MSC2 = 17,
        USB1 MSC3 = 18,
        RAM Disk  = 23 (此為測試用，且只能指定單一個磁碟)。
    help_chs
        指定磁盘号码。最多可指定4个。可设定的磁盘号码：

        SD0       = 0,
        SD1       = 1,
        NAND      = 5,
        NOR       = 6,
        USB0 MSC0 = 7,
        USB0 MSC1 = 8,
        USB0 MSC2 = 9,
        USB0 MSC3 = 10,
        USB1 MSC0 = 15,
        USB1 MSC1 = 16,
        USB1 MSC2 = 17,
        USB1 MSC3 = 18,
        RAM Disk  = 23 (此为测试用，且只能指定单一个磁盘)。

config USBD_LUN_VENDOR_ID
    string
    prompt "USB Device Vendor ID" if DEV_DEVELOP
    depends on USB_DEVICE
    depends on USBD_FILE_STORAGE
    default "'G','e','n','e','r','i','c',' '"
    help
        USB Device Vendor ID, need 8 bytes, format is like this: 'G','e','n','e','r','i','c',' '
    help_cht
        廠商識別字串，共8個字元，格式為: 'G','e','n','e','r','i','c',' '
    help_chs
        厂商标识符串，共8个字符，格式为: 'G','e','n','e','r','i','c',' '

config USBD_LUN0_PRODUCT_ID
    string
    prompt "USB Device Product ID at LUN #0" if DEV_DEVELOP
    depends on USB_DEVICE
    depends on USBD_FILE_STORAGE
    default "'S','t','o','r','a','g','e',' ','I','N','T','E','R','N','A','L'"
    help
        USB Device Product ID at LUN #0, need 16 bytes, format is like this: 'S','t','o','r','a','g','e',' ','I','N','T','E','R','N','A','L'
    help_cht
        第 0 個磁碟的產品識別字串，共16個字元，格式: 'S','t','o','r','a','g','e',' ','I','N','T','E','R','N','A','L'
    help_chs
        第 0 个磁盘的产品标识符串，共16个字符，格式: 'S','t','o','r','a','g','e',' ','I','N','T','E','R','N','A','L'

config USBD_LUN1_PRODUCT_ID
    string
    prompt "USB Device Product ID at LUN #1" if DEV_DEVELOP
    depends on USB_DEVICE
    depends on USBD_FILE_STORAGE
    default "'S','t','o','r','a','g','e',' ','C','A','R','D',' ','1',' ',' '"
    help
        USB Device Product ID at LUN #1, need 16 bytes, format is like this: 'S','t','o','r','a','g','e',' ','C','A','R','D',' ','1',' ',' '
    help_cht
        第 1 個磁碟的產品識別字串，共16個字元，格式: 'S','t','o','r','a','g','e',' ','C','A','R','D',' ','1',' ',' '
    help_chs
        第 1 个磁盘的产品标识符串，共16个字元，格式: 'S','t','o','r','a','g','e',' ','C','A','R','D',' ','1',' ',' '

config USBD_LUN2_PRODUCT_ID
    string
    prompt "USB Device Product ID at LUN #2" if DEV_DEVELOP
    depends on USB_DEVICE
    depends on USBD_FILE_STORAGE
    default "'S','t','o','r','a','g','e',' ','C','A','R','D',' ','2',' ',' '"
    help
        USB Device Product ID at LUN #2, need 16 bytes, format is like this: 'S','t','o','r','a','g','e',' ','C','A','R','D',' ','2',' ',' '
    help_cht
        第 2 個磁碟的產品識別字串，共16個字元，格式: 'S','t','o','r','a','g','e',' ','C','A','R','D',' ','2',' ',' '
    help_chs
        第 2 个磁盘的产品标识符串，共16个字元，格式: 'S','t','o','r','a','g','e',' ','C','A','R','D',' ','2',' ',' '

config USBD_LUN3_PRODUCT_ID
    string
    prompt "USB Device Product ID at LUN #3" if DEV_DEVELOP
    depends on USB_DEVICE
    depends on USBD_FILE_STORAGE
    default "'S','t','o','r','a','g','e',' ','C','A','R','D',' ','3',' ',' '"
    help
        USB Device Product ID at LUN #3, need 16 bytes, format is like this: 'S','t','o','r','a','g','e',' ','C','A','R','D',' ','3',' ',' '
    help_cht
        第 3 個磁碟的產品識別字串，共16個字元，格式: 'S','t','o','r','a','g','e',' ','C','A','R','D',' ','3',' ',' '
    help_chs
        第 3 个磁盘的产品标识符串，共16个字元，格式: 'S','t','o','r','a','g','e',' ','C','A','R','D',' ','3',' ',' '
```

## sdk/sdk/share/Kconfig
```kconfig
#
# For a description of the syntax of this configuration file,
# see Documentation/kbuild/kconfig-language.txt.
#

source "$CMAKE_SOURCE_DIR/sdk/share/dhcps/Kconfig"
source "$CMAKE_SOURCE_DIR/sdk/share/eXosip2/Kconfig"
source "$CMAKE_SOURCE_DIR/sdk/share/ffmpeg/Kconfig"
source "$CMAKE_SOURCE_DIR/sdk/share/itc/Kconfig"
source "$CMAKE_SOURCE_DIR/sdk/share/itu/Kconfig"
source "$CMAKE_SOURCE_DIR/sdk/share/linphone/Kconfig"
source "$CMAKE_SOURCE_DIR/sdk/share/mediastreamer2/Kconfig"
source "$CMAKE_SOURCE_DIR/sdk/share/sdl/Kconfig"
source "$CMAKE_SOURCE_DIR/sdk/share/sdl_image/Kconfig"
source "$CMAKE_SOURCE_DIR/sdk/share/sdl_ttf/Kconfig"
source "$CMAKE_SOURCE_DIR/sdk/share/upgrade/Kconfig"
source "$CMAKE_SOURCE_DIR/sdk/share/xml2/Kconfig"
```

## sdk/sdk/share/dhcps/Kconfig
```kconfig
#
# For a description of the syntax of this configuration file,
# see Documentation/kbuild/kconfig-language.txt.
#

if BUILD_DHCPS

menu "dhcps"

config DHCPS_ADDR_COUNT
    string "Maximum offer address count"
    depends on BUILD_DHCPS
    default "254"
    help
        Maximum offer address count, must between 1 ~ 254.
    help_cht
        提供最大 IP 地址的數量，必須在 1 ~ 254 之間。
    help_chs
        提供最大 IP 地址的数量，必须在 1 ~ 254 之间。

endmenu

endif # BUILD_DHCPS
```

## sdk/sdk/share/eXosip2/Kconfig
```kconfig
#
# For a description of the syntax of this configuration file,
# see Documentation/kbuild/kconfig-language.txt.
#
config BUILD_OSIP2
	def_bool y if BUILD_EXOSIP2
```

## sdk/sdk/share/ffmpeg/Kconfig
```kconfig
#
# For a description of the syntax of this configuration file,
# see Documentation/kbuild/kconfig-language.txt.
#

# if BUILD_FFMPEG

config BUILD_ITC
    def_bool y if BUILD_FFMPEG

config BUILD_ZLIB
    def_bool y if BUILD_FFMPEG

menu "ffmpeg"
depends on VIDEO_ENABLE

config FFMPEG_ENC
    bool "Enable Encoders"
    default n
    help
        Enable Encoders.
    help_cht
        開啟編碼器的功能。
    help_chs
        开启编码器的功能。

config FFMPEG_H264_SW
    bool "Use Software H.264"
    default n
    help
        Use Software H.264.
    help_cht
        使用軟體的 H.264。
    help_chs
        使用软件的 H.264。

endmenu

# endif # BUILD_FFMPEG
```

## sdk/sdk/share/itc/Kconfig
```kconfig
#
# For a description of the syntax of this configuration file,
# see Documentation/kbuild/kconfig-language.txt.
#

if BUILD_ITC

menu "itc"

config ITC_ERR
    bool "Error Log"
    default y
    help
        Output error log.
    help_cht
        輸出錯誤訊息。
    help_chs
        输出错误讯息。

config ITC_WARN
    bool "Warning Log"
    default y
    help
        Output warning log.
    help_cht
        輸出警告訊息。
    help_chs
        输出警告讯息。

config ITC_INFO
    bool "Information Log"
    default y
    help
        Output information log.
    help_cht
        輸出資訊訊息。
    help_chs
        输出资讯讯息。

config ITC_DBG
    bool "Debug Log"
    default n
    help
        Output debug log.
    help_cht
        輸出除錯訊息。
    help_chs
        输出侦错讯息。

endmenu

endif # BUILD_ITC
```

## sdk/sdk/share/itu/Kconfig
```kconfig
#
# For a description of the syntax of this configuration file,
# see Documentation/kbuild/kconfig-language.txt.
#

if BUILD_ITU

menu "itu"

config ITU_ERR
    bool "Error Log"
    default y
    help
        Output error log.
    help_cht
        輸出錯誤訊息。
    help_chs
        输出错误讯息。

config ITU_WARN
    bool "Warning Log"
    default y
    help
        Output warning log.
    help_cht
        輸出警告訊息。
    help_chs
        输出警告讯息。

config ITU_INFO
    bool "Information Log"
    default y
    help
        Output information log.
    help_cht
        輸出資訊訊息。
    help_chs
        输出资讯讯息。

config ITU_DBG
    bool "Debug Log"
    default n
    help
        Output debug log.
    help_cht
        輸出除錯訊息。
    help_chs
        输出侦错讯息。

config ITU_LOAD
    bool "Load Log"
    default n
    help
        Output load log.
    help_cht
        輸出讀取訊息。
    help_chs
        输出读取讯息。

config ITU_UPDATE
    bool "Update Log"
    default n
    help
        Output update log.
    help_cht
        輸出更新訊息。
    help_chs
        输出更新讯息。

config ITU_DRAW
    bool "Draw Log"
    default n
    help
        Output draw log.
    help_cht
        輸出繪圖訊息。
    help_chs
        输出绘图讯息。

config ITU_FT_CACHE_ENABLE
    bool "FreeType cache enable"
    default n
    help
        FreeType cache enable or not.
    help_cht
        開啟 FreeType 快取功能。
    help_chs
        开启 FreeType 快取功能。

config ITU_FT_CACHE_SIZE
    string "FreeType cache size"
    depends on ITU_FT_CACHE_ENABLE
    default "0x7D000"
    help
        FreeType cache size.
    help_cht
        設定 FreeType 快取大小。
    help_chs
        设定 FreeType 快取大小。

config ITU_UCL_ENABLE
    bool "Use software decompress"
    default n
    help
        Use software decompress or not.
    help_cht
        使用軟體解壓縮功能。
    help_chs
        使用软件解压缩功能。

config ITU_ASSERT_THREAD
    bool "Assert thread"
    default n
    help
        Assert call APIs on the same thread.
    help_cht
        開啟呼叫APIs時是否在同一執行緒的功能。
    help_chs
        开启呼叫的API时是否在同一执行绪的功能。

endmenu

config BUILD_FFMPEG
    def_bool y if (BUILD_ITU && VIDEO_ENABLE)

config BUILD_FREETYPE
    def_bool y if BUILD_ITU

config BUILD_ITC
    def_bool y if BUILD_ITU

config BUILD_JPEG
    def_bool y if (BUILD_ITU && !JPEG_HW_ENABLE)

config BUILD_PNG
    def_bool y if BUILD_ITU

config BUILD_REDBLACK
    def_bool y if BUILD_ITU

config BUILD_UCL
    def_bool y if (BUILD_ITU && ITU_UCL_ENABLE)

config BUILD_ZLIB
    def_bool y if BUILD_ITU

endif # BUILD_ITU
```

## sdk/sdk/share/linphone/Kconfig
```kconfig
#
# For a description of the syntax of this configuration file,
# see Documentation/kbuild/kconfig-language.txt.
#
config BUILD_MEDIASTREAMER2
	def_bool y if BUILD_LINPHONE
	
```

## sdk/sdk/share/mediastreamer2/Kconfig
```kconfig
#
# For a description of the syntax of this configuration file,
# see Documentation/kbuild/kconfig-language.txt.
#

config BUILD_EXOSIP2
	def_bool y if BUILD_MEDIASTREAMER2

config BUILD_FFMPEG
	def_bool y if (BUILD_MEDIASTREAMER2 && LCD_ENABLE)

config BUILD_LWIP
	def_bool y if BUILD_MEDIASTREAMER2

config BUILD_SDL
	def_bool y if BUILD_MEDIASTREAMER2

config BUILD_SPEEX
	def_bool y if BUILD_MEDIASTREAMER2

config BUILD_ORTP
	def_bool y if BUILD_MEDIASTREAMER2
	
```

## sdk/sdk/share/sdl/Kconfig
```kconfig
#
# For a description of the syntax of this configuration file,
# see Documentation/kbuild/kconfig-language.txt.
#

config BUILD_OPENVG_RI
	def_bool y if (BUILD_SDL && OPENVG_SW)

config BUILD_OPENVG
	def_bool y if (BUILD_SDL && OPENVG_ENABLE && !OPENVG_SW)
```

## sdk/sdk/share/sdl_image/Kconfig
```kconfig
#
# For a description of the syntax of this configuration file,
# see Documentation/kbuild/kconfig-language.txt.
#

config BUILD_JPEG
	def_bool y if BUILD_SDL_IMAGE

config BUILD_PNG
	def_bool y if BUILD_SDL_IMAGE

config BUILD_SDL
	def_bool y if BUILD_SDL_IMAGE
	
config BUILD_ZLIB
	def_bool y if BUILD_SDL_IMAGE
```

## sdk/sdk/share/sdl_ttf/Kconfig
```kconfig
#
# For a description of the syntax of this configuration file,
# see Documentation/kbuild/kconfig-language.txt.
#

config BUILD_FREETYPE
	def_bool y if BUILD_SDL_TTF
	
config BUILD_SDL
	def_bool y if BUILD_SDL_TTF
```

## sdk/sdk/share/upgrade/Kconfig
```kconfig
#
# For a description of the syntax of this configuration file,
# see Documentation/kbuild/kconfig-language.txt.
#

if BUILD_UPGRADE

config BUILD_ITC
    def_bool y if BUILD_UPGRADE

menu "upgrade"

config UG_ERR
    bool "Error Log"
    default y
    help
        Output error log.
    help_cht
        輸出錯誤訊息。
    help_chs
        输出错误讯息。

config UG_WARN
    bool "Warning Log"
    default y
    help
        Output warning log.
    help_cht
        輸出警告訊息。
    help_chs
        输出警告讯息。

config UG_INFO
    bool "Information Log"
    default y
    help
        Output information log.
    help_cht
        輸出資訊訊息。
    help_chs
        输出资讯讯息。

config UG_DBG
    bool "Debug Log"
    default n
    help
        Output debug log.
    help_cht
        輸出除錯訊息。
    help_chs
        输出侦错讯息。

config UG_BUF_SIZE
    string "Upgrade used buffer size"
    default "0x20000"
    help
        Upgrade used buffer size.
    help_cht
        內部緩衝區記憶體大小。
    help_chs
        内部缓冲区内存大小。

endmenu

endif # BUILD_UPGRADE
```

## sdk/sdk/share/xml2/Kconfig
```kconfig
#
# For a description of the syntax of this configuration file,
# see Documentation/kbuild/kconfig-language.txt.
#

config BUILD_ZLIB
	def_bool y if BUILD_XML2
```

## sdk/win32/Kconfig
```kconfig
#
# For a description of the syntax of this configuration file,
# see Documentation/kbuild/kconfig-language.txt.
#

menu "Win32"

config WIN32_FS_HW
	bool "Use hardware filesystem"
	default n

config WIN32_SIMULATOR
	bool "Simulator"
	default n

config WIN32_LWIP_ADAPTER
	string "lwIP Adapter Index"
	depends on NET_ENABLE
	default "0"
	help
	    the index of the windows network adapter to use

config TEMP_DRIVE
    default "T"

endmenu
```
