## sdk/project/test_input/Kconfig
```kconfig
#
# For a description of the syntax of this configuration file,
# see Documentation/kbuild/kconfig-language.txt.
#

mainmenu "Project Configuration"

config TEST_INPUT
    bool
    default y
    select HAVE_LCD
    select HAVE_GRAPHICS
    select HAVE_AUDIO
    select HAVE_VIDEO

config CMAKE_SOURCE_DIR
	string
	option env="CMAKE_SOURCE_DIR"

config DEF_CHIP_PKG_IT9854
    def_bool y

config DEF_CHIP_REV_A0
    def_bool y  

config RAM_SIZE
    default "0x4000000"

config RAM_INIT_SCRIPT
    default "IT9850A0_360MHz.scr"

config DCPS_ENABLE
    def_bool y

config FONT_FILENAME
    default "WenQuanYiMicroHeiMono.ttf"

config BACKLIGHT_ENABLE
    def_bool y

config BACKLIGHT_DUTY_CYCLES
    default "95, 92, 88, 82, 75, 65, 55, 40, 25, 5"

config BACKLIGHT_DEFAULT_DUTY_CYCLE
    default "5"

config LCD_ENABLE
    def_bool y

config LCD_WIDTH
    default "800"

config LCD_HEIGHT
    default "480"

config LCD_PITCH
    default "1600"

config LCD_INIT_SCRIPT
    default "IT9850_LCD_800_480_Allentech_7inch_565.txt.in"

config LCD_TRIPLE_BUFFER
    default n

config CMDQ_ENABLE
    def_bool y

config M2D_ENABLE
    def_bool y

config JPEG_HW_ENABLE
    def_bool y

config AUDIO_ENABLE
    def_bool y

config AUDIO_DAC_MODULE
    default "itp_dac_alc5616.c"

config AUDIO_CODEC_MP3DEC
    def_bool y

config AUDIO_CODEC_WMADEC
    def_bool y

config AUDIO_CODEC_WAV
    def_bool y

config VIDEO_ENABLE
    def_bool y

config KEYPAD_ENABLE
    def_bool n

config USB0_ENABLE
    def_bool y

config MSC_ENABLE
    def_bool y

config FS_FAT
    def_bool y

config I2C0_ENABLE
    def_bool y

config DEF_IIC0_GPIO_CONFIG_1
    def_bool y

config I2C1_ENABLE
    def_bool y

config DEF_IIC1_GPIO_CONFIG_1
    def_bool y

config TOUCH_ENABLE
    def_bool y

config TOUCH_MODULE
    default "ft5316"

config TOUCH_X_MAX_VALUE
    default "0x31F"

config TOUCH_Y_MAX_VALUE
    default "0x1DF"

config GPIO_TOUCH_INT
    default "38"

config GPIO_TOUCH_WAKE
    default "-1"

config DEF_TOUCH_I2C1
    def_bool y

config I2S_ENABLE
    def_bool y

config I2S_SPDIF_ENABLE
    def_bool n

config UART1_ENABLE
    def_bool y

config GPIO_UART1_TX
    default "4"

config GPIO_UART1_RX
    default "-1"

config GPIO_BACKLIGHT_PWM
    default "64"

config TASK_DRIVE_PROBE
    def_bool y

config DEF_DBG_UART1
    def_bool y

config DBG_INIT_SCRIPT
    default "IT9850A0_400MHz.txt"

config ITU_FT_CACHE_ENABLE
    def_bool y

config ITU_FT_CACHE_SIZE
    default "0xFA000"

config BUILD_ITU
    def_bool y

config BUILD_PYINPUT
    def_bool y

config BUILD_AUDIO_MGR
    def_bool y

config BUILD_SDL
    def_bool y

source "$CMAKE_SOURCE_DIR/sdk/Kconfig"
```

## sdk/project/test_itu/Kconfig.win32
```kconfig
#
# For a description of the syntax of this configuration file,
# see Documentation/kbuild/kconfig-language.txt.
#

mainmenu "Project Configuration"

config TEST_ITU
    bool
    default y
    select HAVE_LCD
    select HAVE_GRAPHICS
    select HAVE_AUDIO
    select HAVE_VIDEO

config CMAKE_SOURCE_DIR
	string
	option env="CMAKE_SOURCE_DIR"

config LCD_ENABLE
    def_bool y

config I2S_ENABLE
    def_bool y

config I2S_SPDIF_ENABLE
    def_bool n

config AUDIO_ENABLE
    def_bool y

config VIDEO_ENABLE
    def_bool y

config FFMPEG_H264_SW
    def_bool y

config ITU_UCL_ENABLE
    def_bool y

config WIN32_SIMULATOR
    def_bool y

config ITU_FT_CACHE_ENABLE
    def_bool y

config BUILD_AUDIO_MGR
    def_bool y

config BUILD_ITU
    def_bool y

config BUILD_SDL
    def_bool y

source "$CMAKE_SOURCE_DIR/sdk/Kconfig"

menu "ITU Test"

choice
	prompt "Test App"
	default TEST_SDL

config TEST_SDL
	bool "SDL"

config TEST_STNLCD
	bool "STNLCD"

config TEST_HELLOWORLD
	bool "HELLOWORLD"

config TEST_BUTTON
	bool "BUTTON"

config TEST_LANGUAGE
	bool "LANGUAGE"

config TEST_CURSOR
	bool "CURSOR"

config TEST_PROGRESSBAR
	bool "PROGRESSBAR"

config TEST_LISTBOX
	bool "LISTBOX"

config TEST_TRACKBAR
	bool "TRACKBAR"

config TEST_ARRAY
	bool "ARRAY"

config TEST_JPEG
	bool "JPEG"

config TEST_MULTILINE
	bool "MULTILINE"

config TEST_COMPRESS
	bool "COMPRESS"

config TEST_FUNCTION
	bool "FUNCTION"

config TEST_LISTBOX2
	bool "LISTBOX2"

config TEST_CUSTOM
	bool "CUSTOM"

config TEST_ICONLISTBOX
	bool "ICONLISTBOX"

config TEST_CIRCLEPROGRESSBAR
	bool "CIRCLEPROGRESSBAR"

config TEST_DRAW
	bool "DRAW"

config TEST_SCROLLBAR
	bool "SCROLLBAR"

config TEST_WHEEL
	bool "WHEEL"

config TEST_COVERFLOW
	bool "COVERFLOW"

config TEST_SCROLLLISTBOX
	bool "SCROLLLISTBOX"

config TEST_METER
	bool "METER"

config TEST_VIDEO
	bool "VIDEO"

config TEST_COLORPICKER
	bool "COLORPICKER"

config TEST_IMAGECOVERFLOW
	bool "IMAGECOVERFLOW"

config TEST_CURVE
	bool "CURVE"

config TEST_TABLELISTBOX
	bool "TABLELISTBOX"

config TEST_PNG
	bool "PNG"

config TEST_TABLEICONLISTBOX
	bool "TABLEICONLISTBOX"

config TEST_MULTIFONT
	bool "MULTIFONT"

config TEST_CLONE
	bool "CLONE"

config TEST_TABLELISTBOX2
	bool "TABLELISTBOX2"

config TEST_ANIMPAGE
	bool "ANIMPAGE"

config TEST_BITBLT
	bool "BITBLT"

config TEST_FILESLIDESHOW
	bool "FILESLIDESHOW"

config TEST_SHOWLOGO
	bool "SHOWLOGO"

config TEST_MULTIGESTURE
	bool "MULTIGESTURE"

config TEST_CLIPPINGCOLOR
	bool "CLIPPINGCOLOR"

config TEST_ROTATE
	bool "ROTATE"

endchoice

endmenu
```

## sdk/project/test_jpg/Kconfig
```kconfig
#
# For a description of the syntax of this configuration file,
# see Documentation/kbuild/kconfig-language.txt.
#

mainmenu "Project Configuration"

config TEST_capture_module
    bool
    default y
    select HAVE_LCD
    select HAVE_GRAPHICS
    select HAVE_VIDEO

config CMAKE_SOURCE_DIR
	string
    option env="CMAKE_SOURCE_DIR"

config DEF_CHIP_PKG_IT9856
    def_bool y

config DEF_CHIP_REV_A0
    def_bool y 

config RAM_SIZE
    default "0x4000000"

config RAM_INIT_SCRIPT
    default "IT9850A0_400MHz.scr"

config DCPS_ENABLE
    def_bool y


config LCD_ENABLE
    def_bool y

config LCD_WIDTH
    default "800"

config LCD_HEIGHT
    default "480"

config LCD_PITCH
    default "1600"

config LCD_INIT_SCRIPT
    default "IT9850_LCD_800_480_Allentech_7inch_565.txt.in"

config BACKLIGHT_ENABLE
    def_bool y

config BACKLIGHT_DUTY_CYCLES
    default "95, 92, 88, 82, 75, 65, 55, 40, 25, 5"

config BACKLIGHT_DEFAULT_DUTY_CYCLE
    default "5"

config GPIO_BACKLIGHT_PWM
     default "64"

config CMDQ_ENABLE
    def_bool y

config M2D_ENABLE
    def_bool y
    
config DBG_INIT_SCRIPT
    default "IT9850A0_400MHz.txt"

config USB0_ENABLE
    def_bool y

config MSC_ENABLE
    def_bool y
    
config FS_FAT
	def_bool y

config TASK_DRIVE_PROBE
	default y

config NOR_ENABLE
    def_bool y

config NOR_CACHE_SIZE
    default "0x80000"

config NOR_RESERVED_SIZE
    default "0x600000"

config NOR_PARTITION0
    def_bool y

config NOR_PARTITION0_SIZE
    default "0x800000"

config NOR_PARTITION1
    def_bool y

config NOR_PARTITION1_SIZE
    default "0xA0000"

config NOR_PARTITION2
    def_bool y
    


config I2C0_ENABLE
    def_bool y

config I2C1_ENABLE
    def_bool y
    
config VIDEO_ENABLE
    def_bool y
	
config JPEG_HW_ENABLE
	default y
	
config UART1_ENABLE
    def_bool y

config GPIO_UART1_TX
    default "4"

config GPIO_UART1_RX
    default "-1"
	
config TASK_DRIVE_PROBE	
	def_bool y

config BUILD_ITU
    def_bool y

config BUILD_SDL
    def_bool y
    
config ITU_UCL_ENABLE
    def_bool y

config DEF_DBG_UART1
    def_bool y
source "$CMAKE_SOURCE_DIR/sdk/Kconfig"
```

## sdk/project/test_jpg/Kconfig.win32
```kconfig
#
# For a description of the syntax of this configuration file,
# see Documentation/kbuild/kconfig-language.txt.
#

mainmenu "Project Configuration"

config TEST_JPG
    bool
    default y
    select HAVE_LCD
    select HAVE_GRAPHICS
    select HAVE_VIDEO
    select HAVE_AUDIO

config CMAKE_SOURCE_DIR
    string
    option env="CMAKE_SOURCE_DIR"

config DEF_CHIP_PKG_IT9856
    def_bool y

config DEF_CHIP_REV_A0
    def_bool y  

config RAM_SIZE
    default "0x4000000"

config RAM_INIT_SCRIPT
    default "IT9850A0_400MHz_tiling_pitch2048.scr"

config LCD_ENABLE
    def_bool y

config LCD_WIDTH
    default "800"

config LCD_HEIGHT
    default "480"
    
config LCD_PITCH
    default "1600"

config LCD_INIT_SCRIPT
    default "IT9850_LCD_800_480_Allentech_7inch_565.txt.in"

config BACKLIGHT_ENABLE
    def_bool y

config BACKLIGHT_DUTY_CYCLES
    default "95, 92, 88, 82, 75, 65, 55, 40, 25, 5"

config GPIO_BACKLIGHT_PWM
     default "64"

config BACKLIGHT_DEFAULT_DUTY_CYCLE
    default "5"
    
config CMDQ_ENABLE
    def_bool y

config M2D_ENABLE
    def_bool y

config JPEG_HW_ENABLE
	default y

config DBG_INIT_SCRIPT
    default "IT9850A0_400MHz.txt"

config BUILD_FFMPEG
    def_bool y

config VIDEO_ENABLE
    def_bool y

config WIN32_SIMULATOR
    def_bool n

config FS_FAT
    def_bool y
    
config ITU_UCL_ENABLE
    def_bool y
 
config BUILD_ITU
    def_bool y

config BUILD_SDL
    def_bool y

source "$CMAKE_SOURCE_DIR/sdk/Kconfig"
```

## sdk/project/test_jpg/Kconfig.win32_9920
```kconfig
#
# For a description of the syntax of this configuration file,
# see Documentation/kbuild/kconfig-language.txt.
#

mainmenu "Project Configuration"


config TEST_VIDEO
    bool
    default y
    select HAVE_LCD
    select HAVE_GRAPHICS
    select HAVE_VIDEO
	
config LCD_ENABLE
    def_bool y
	
config VIDEO_ENABLE
    def_bool y

config CMAKE_SOURCE_DIR
	string
	option env="CMAKE_SOURCE_DIR"

config DEF_CHIP_PKG_IT9920 
    def_bool y

config DEF_CHIP_REV_A0
    def_bool y  

config DEF_CPU_FA626
	def_bool y

config LCD_ENABLE
    def_bool y

config LCD_WIDTH
    default "800"

config LCD_HEIGHT
    default "480"
    
config LCD_PITCH
    default "1600"

config JPEG_HW_ENABLE
	default y

config LCD_INIT_SCRIPT
    default "1.9920.panel_800_480_innolux_7inch_src565_dst24bit.txt.in"

config DBG_INIT_SCRIPT
    default "p9920a0_MEM60M_0901TOP_v7.txt"

source "$CMAKE_SOURCE_DIR/sdk/Kconfig"
```

## sdk/project/test_lcd/Kconfig.indoor
```kconfig
#
# For a description of the syntax of this configuration file,
# see Documentation/kbuild/kconfig-language.txt.
#

mainmenu "Project Configuration"

config TEST_LCD
    bool
    default y
    select HAVE_LCD
    select HAVE_GRAPHICS
    select HAVE_AUDIO
    select HAVE_VIDEO

config CMAKE_SOURCE_DIR
    string
    option env="CMAKE_SOURCE_DIR"

config DEF_CHIP_PKG_IT9856
    def_bool y

config DEF_CHIP_REV_A0
    def_bool y  

config RAM_SIZE
    default "0x4000000"

config RAM_INIT_SCRIPT
    default "IT9850A0_400MHz.scr"

config LCD_ENABLE
    def_bool y

config LCD_WIDTH
    default "800"

config LCD_HEIGHT
    default "480"

config LCD_PITCH
    default "1600"

config LCD_INIT_SCRIPT
    default "IT9850_LCD_800_480_Allentech_7inch_565.txt.in"

config BACKLIGHT_ENABLE
    def_bool y

config BACKLIGHT_DUTY_CYCLES
    default "95, 92, 88, 82, 75, 65, 55, 40, 25, 5"

config BACKLIGHT_DEFAULT_DUTY_CYCLE
    default "5"

config GPIO_BACKLIGHT_PWM
     default "64"

config UART1_ENABLE
    def_bool y

config GPIO_UART1_TX
    default "4"

config GPIO_UART1_RX
    default "-1"

config DEF_DBG_UART1
    def_bool y

config DBG_INIT_SCRIPT
    default "IT9850A0_400MHz.txt"

source "$CMAKE_SOURCE_DIR/sdk/Kconfig"

menu "LCD Test"

    choice
        prompt "Test App"
        default TEST_LCD_COLOR

    config TEST_LCD_COLOR
        bool "LCD_COLOR"

    config TEST_LCD_INTR
        bool "LCD_INTR"

    config TEST_LCDCONSOLE
        bool "LCDCONSOLE"

    config TEST_OSDCONSOLE
        bool "OSDCONSOLE"

    config TEST_BACKLIGHT
        bool "BACKLIGHT"

    config TEST_STNLCD
        bool "STNLCD"

    endchoice

endmenu
```

## sdk/project/test_lcd/Kconfig.win32
```kconfig
#
# For a description of the syntax of this configuration file,
# see Documentation/kbuild/kconfig-language.txt.
#

mainmenu "Project Configuration"

config TEST_LCD
    bool
    default y
    select HAVE_LCD
    select HAVE_GRAPHICS
    select HAVE_AUDIO
    select HAVE_VIDEO

config CMAKE_SOURCE_DIR
    string
    option env="CMAKE_SOURCE_DIR"

config DEF_CHIP_PKG_IT9852
    def_bool y

config DEF_CHIP_REV_A0
    def_bool y  

config RAM_SIZE
    default "0x4000000"

config RAM_INIT_SCRIPT
    default "IT9850A0_400MHz.scr"

config LCD_ENABLE
    def_bool y

config LCD_WIDTH
    default "480"

config LCD_HEIGHT
    default "272"

config LCD_PITCH
    default "960"

config LCD_INIT_SCRIPT
    default "IT9850_LCD_480_272_innolux_4.3inch_565.txt.in"

config BACKLIGHT_ENABLE
    def_bool y

config BACKLIGHT_DUTY_CYCLES
    default "95, 92, 88, 82, 75, 65, 55, 40, 25, 5"

config BACKLIGHT_DEFAULT_DUTY_CYCLE
    default "5"

config GPIO_BACKLIGHT_PWM
     default "64"

config DBG_INIT_SCRIPT
    default "IT9850A0_400MHz.txt"

source "$CMAKE_SOURCE_DIR/sdk/Kconfig"

menu "LCD Test"

    choice
        prompt "Test App"
        default TEST_LCD_COLOR

    config TEST_LCD_COLOR
        bool "LCD_COLOR"

    config TEST_LCD_INTR
        bool "LCD_INTR"

    config TEST_LCDCONSOLE
        bool "LCDCONSOLE"

    config TEST_OSDCONSOLE
        bool "OSDCONSOLE"

    config TEST_BACKLIGHT
        bool "BACKLIGHT"

    config TEST_STNLCD
        bool "STNLCD"

    endchoice

endmenu
```
