## sdk/project/elevator2/Kconfig
```kconfig
#
# For a description of the syntax of this configuration file,
# see Documentation/kbuild/kconfig-language.txt.
#

mainmenu "Project Configuration"

config ELEVATOR
    bool
    default y
    select HAVE_LCD
    select HAVE_GRAPHICS
    select HAVE_AUDIO
    select HAVE_VIDEO

config CMAKE_SOURCE_DIR
	string
	option env="CMAKE_SOURCE_DIR"

config DEF_CHIP_PKG_IT9854
    def_bool y

config DEF_CHIP_REV_A0
    def_bool y

config RAM_SIZE
    default "0x4000000"   
    
config RAM_INIT_SCRIPT
    default "IT9850A0_360MHz.scr" if !ENABLE_ROTATE
    default "IT9850A0_360MHz_tiling_pitch2048.scr"  if ENABLE_ROTATE

config SET_ROTATE 
    int       
    default 0 if !ENABLE_ROTATE
    default 1 if ENABLE_ROTATE

config TILING_WIDTH_128
    int
    default 0

config WATCHDOG_ENABLE
    def_bool y

config DCPS_ENABLE
    def_bool y

config FONT_FILENAME
    default "wqyMicroHeiProportional.ttf"

config BACKLIGHT_ENABLE
    def_bool y

config BACKLIGHT_DUTY_CYCLES
    default "95, 92, 88, 82, 75, 65, 55, 40, 25, 5"

config BACKLIGHT_DEFAULT_DUTY_CYCLE
    default "5"

config LCD_ENABLE
    def_bool y

config LCD_WIDTH
    default "800"

config LCD_HEIGHT
    default "480"

config LCD_PITCH
    default "1600"

config LCD_INIT_SCRIPT
    default "IT9850_LCD_800_480_Allentech_7inch_565.txt.in"

config CMDQ_ENABLE
    def_bool y

config M2D_ENABLE
    def_bool y

config JPEG_HW_ENABLE
    def_bool y

config AUDIO_ENABLE
    def_bool y

config AUDIO_DAC_MODULE
    default "itp_dac_alc5616.c"

config AUDIO_CODEC_MP3DEC
    def_bool y

config AUDIO_CODEC_MP2DEC
    def_bool y

config AUDIO_CODEC_WMADEC
    def_bool y

config AUDIO_CODEC_WAV
    def_bool y

config COMPRESS_AUDIO_PLUGIN
    def_bool y

config VIDEO_ENABLE
    def_bool y

config KEYPAD_ENABLE
    def_bool y

if KEYPAD_ENABLE
config KEYPAD_MODULE
    default "itp_keypad_it7236.c"

config KEYPAD_MAPPING_TABLE
    default "keypad_elevator2.inc"

config TOUCH_KEYPAD_SET_KEY_NUMBER_ENABLE
    def_bool y
    
config TOUCH_KEY_USE_I2C
    def_bool y

config DEF_TOUCH_I2C1
    def_bool y

config TOUCH_KEY_NUM
    default "5"

config GPIO_KEYPAD
    default "37"
endif

config NOR_ENABLE
    def_bool y

config NOR_CACHE_SIZE
    default "0x200000"

config NOR_RESERVED_SIZE
    default "0x200000"

config NOR_PARTITION0
    def_bool y

config NOR_PARTITION0_SIZE
    default "0x500000"

config NOR_PARTITION1
    def_bool y

config SD0_ENABLE
    def_bool y

config GPIO_SD0_IO
    default "16, 17, 18, 19, 20, 21, -1, -1, -1, -1"

config USB0_ENABLE
    def_bool y

config MSC_ENABLE
    def_bool y

config FS_FAT
    def_bool y

config RTC_ENABLE
    def_bool y

config I2C0_ENABLE
    def_bool y

config DEF_IIC0_GPIO_CONFIG_1
    def_bool y

config I2C1_ENABLE
    def_bool y

config DEF_IIC1_GPIO_CONFIG_1
    def_bool y

config TOUCH_ENABLE
    def_bool n

config TOUCH_MODULE
    default "ft5316"

config TOUCH_X_MAX_VALUE
    default "0x31F"

config TOUCH_Y_MAX_VALUE
    default "0x1DF"

config GPIO_TOUCH_INT
    default "38"

config GPIO_TOUCH_WAKE
    default "-1"

config DEF_TOUCH_I2C1
    def_bool y

config I2S_ENABLE
    def_bool y

config I2S_SPDIF_ENABLE
    def_bool n

config POWER_SAVING_ENABLE
    def_bool y

config DEF_POWER_STANDBY
    def_bool y

config POWER_STANDBY_CPU_FREQ_RATIO
    default "15"

config POWER_STANDBY_BUS_FREQ_RATIO
    default "30"

config UART1_ENABLE
    def_bool y

config GPIO_UART1_TX
    default "4"

config GPIO_UART1_RX
    default "-1"

config UART0_ENABLE
    def_bool y

config GPIO_UART0_TX
    default "34"

config GPIO_UART0_RX
    default "33"

config GPIO_SD0_CARD_DETECT
    default "98"

config GPIO_SD0_POWER_ENABLE
    default "99"

config SPI0_MOSI_GPIO
    default "18"

config SPI0_MISO_GPIO
    default "19"

config SPI0_CLOCK_GPIO
    default "20"

config SPI0_CHIP_SEL_GPIO
    default "14"

config SPI1_ENABLE
    def_bool y

config SPI0_MOSI_GPIO
    default "29"

config SPI0_MISO_GPIO
    default "30"

config SPI0_CLOCK_GPIO
    default "31"

config SPI0_CHIP_SEL_GPIO
    default "15"

config GPIO_BACKLIGHT_PWM
    default "64"

config GPIO_EXPANDER_ENABLE
    default n

config NET_ENABLE
    def_bool n

config TASK_DRIVE_PROBE
    def_bool y

config DEF_DBG_UART1
    def_bool y

config DBG_INIT_SCRIPT
    default "IT9850A0_360MHz.txt"

config DEF_BUILD_MINSIZEREL
    def_bool y

config SYSTEM_NAME
    default "ITE Elevator"

config ITU_FT_CACHE_ENABLE
    def_bool y

config ITU_FT_CACHE_SIZE
    default "0xFA000"

config GCC_LTO
    def_bool y

config BUILD_AUDIO_MGR
    def_bool y

config BUILD_INIPARSER
    def_bool y

config BUILD_ITU
    def_bool y

config BUILD_SDL
    def_bool y

config BUILD_UPGRADE
    def_bool y

if NET_ENABLE
config NET_ETHERNET
    def_bool n

config NET_ETHERNET_LINK_INTR
    def_bool y

config NET_ETHERNET_MAC_ADDR_RANDOM
    def_bool y

config NET_ETHERNET_MAC_ADDR_STORAGE
    def_bool y

if NET_ETHERNET_MAC_ADDR_NOR

config NET_ETHERNET_MAC_ADDR_POS
    default "0x70000"

endif

config NET_ETHERNET_MAC_ADDR_UPGRADE
    def_bool y

config BUILD_LWIP_FTPD
    def_bool y

config BUILD_MICROHTTPD
    def_bool y

config BUILD_XML2
    def_bool y
endif

if NET_WIFI
config NET_WIFI_WPA
    def_bool y

config NET_WIFI_HOSTAPD
    def_bool y

config NET_WIFI_SSID
    default "Elevator"

config NET_WIFI_FIND_BEST_CHANNEL
    default n

config NET_DHCP_SERVER
    def_bool y

config DHCPS_ADDR_COUNT
    default "254"

config CTRLBOARD_REDUCE_PBUFSIZE
    def_bool y
endif

######################################################################
# Start of bootloader setting
######################################################################
config BOOTLOADER_ENABLE
    def_bool n

if BOOTLOADER_ENABLE && LCD_ENABLE

config LCD_BOOT_BITMAP
    default "logo.bmp"

config BL_SHOW_LOGO 
    def_bool y

endif

if BOOTLOADER_ENABLE
config UPGRADE_BOOTLOADER
    def_bool y

config UPGRADE_IMAGE
    def_bool y

if UPGRADE_IMAGE_NOR

config UPGRADE_IMAGE_POS
    default "0x80000"

endif

config UPGRADE_DATA
    def_bool y

config UPGRADE_PUBLIC
    def_bool y

config UPGRADE_OPEN_FILE
    def_bool y

config UPGRADE_PARTITION
    def_bool y

config UPGRADE_DELETE_PKGFILE_AFTER_FINISH
    def_bool y

config UPGRADE_NOR_IMAGE
    def_bool y

config UPGRADE_NOR_IMAGE_SIZE
    default "0x1000000"

config BL_LCD_CONSOLE
    def_bool y

config BL_ERR
    def_bool y

config BL_WARN
    def_bool y

config BL_INFO
    def_bool y

config BL_DBG
    def_bool y

endif

######################################################################
# End of bootloader setting
######################################################################

source "$CMAKE_SOURCE_DIR/sdk/Kconfig"

######################################################################
# Project Menu
######################################################################
menu "Elevator"

    config CHECK_FILES_CRC_ON_BOOTING
        bool "Checking files' CRC on booting time"
        default n
        help
            Checking files' CRC on booting time
        help_cht
            開啟開機時檢查檔案 CRC 值的功能。
        help_chs
            开启开机时检查档案 CRC 值的功能。

    config ITU_PATH
        string "ITU files path"
        default "itu/800x480"
        help
            ITU files path
        help_cht
            ITU檔案路徑。
        help_chs
            ITU档案路径。

    config RES_PATH
        string "Resource files path"
        default "res"
        help
            Resource files path
        help_cht
            資源檔案路徑。
        help_chs
            资源档案路径。

    config UPGRADE_GUI
        bool "Upgrade by graphics display"
        default n
        help
            Upgrade by graphics display
        help_cht
            圖形顯示更新。
        help_chs
            图形显示更新。

    config WEBSERVER_PORT
        string "Web server port"
        default "80"
        help
            Web server port
        help_cht
            網頁伺服器埠號。
        help_chs
            网页服务器埠号。

    config UPGRADE_DATA_URL
        string "Upgrade data URL"
        default "http://192.168.1.1/elevator2/"
        help
            Upgrade data URL
        help_cht
            網路更新Data路徑。
        help_chs
            网络更新Data路径。

    config UPGRADE_FW_URL
        string "Upgrade firmware URL"
        default "ftp://192.168.1.1/elevator2/ITEPKG03.PKG"
        help
            Upgrade firmware URL
        help_cht
            網路更新F/W路徑。
        help_chs
            网络更新F/W路径。

endmenu
```

## sdk/project/elevator2/Kconfig.win32
```kconfig
#
# For a description of the syntax of this configuration file,
# see Documentation/kbuild/kconfig-language.txt.
#

mainmenu "Project Configuration"

config ELEVATOR
    bool
    default y
    select HAVE_LCD
    select HAVE_GRAPHICS
    select HAVE_AUDIO

config CMAKE_SOURCE_DIR
	string
	option env="CMAKE_SOURCE_DIR"

config RAM_SIZE
    default "0x4000000"

config RAM_INIT_SCRIPT
    default "IT9079A1_Initial_DDR2_Mem_tiling_pitch2048_360MHZ.scr"

config WATCHDOG_ENABLE
    def_bool y

config FONT_FILENAME
    default "wqyMicroHeiProportional.ttf"

config BACKLIGHT_ENABLE
    def_bool y

config BACKLIGHT_DUTY_CYCLES
    default "95, 92, 88, 82, 75, 65, 55, 40, 25, 5"

config BACKLIGHT_DEFAULT_DUTY_CYCLE
    default "5"

config LCD_ENABLE
    def_bool y

config LCD_WIDTH
    default "800"

config LCD_HEIGHT
    default "480"

config LCD_PITCH
    default "1600"

config LCD_INIT_SCRIPT
    default "IT9850_LCD_800_480_innolux_7inch_888.txt.in"

config CMDQ_ENABLE
    def_bool y

config AUDIO_ENABLE
    def_bool y

config SD0_ENABLE
    def_bool y

config FS_FAT
    def_bool y

config I2C0_ENABLE
    def_bool y

config I2S_ENABLE
    def_bool y

config I2S_SPDIF_ENABLE
    def_bool n

config UART1_ENABLE
    def_bool y

config DEF_IIC0_GPIO_CONFIG_2
    def_bool y

config NET_ENABLE
    def_bool n

if NET_ENABLE

config NET_ETHERNET
    def_bool y

config NET_HTTP
    def_bool y

config NET_FTP
    def_bool y

config BUILD_LWIP_FTPD
    def_bool y

config BUILD_MICROHTTPD
    def_bool y

config BUILD_XML2
    def_bool y

endif    

config DEF_DBG_UART1
    def_bool y

config DBG_INIT_SCRIPT
    default "IT9079A1_Initial_DDR2_Mem_tiling_pitch2048_320MHZ.txt"

config DEF_BUILD_DEBUG
    def_bool y

config SYSTEM_NAME
    default "ITE Elevator"

config UPGRADE_DELETE_PKGFILE_AFTER_FINISH
    def_bool y

config WIN32_SIMULATOR
    def_bool y

config ITU_FT_CACHE_ENABLE
    def_bool y

config ITU_UCL_ENABLE
    def_bool y

config BUILD_AUDIO_MGR
    def_bool y

config BUILD_INIPARSER
    def_bool y

config BUILD_ITU
    def_bool y

config BUILD_SDL
    def_bool y

config BUILD_UPGRADE
    def_bool y

source "$CMAKE_SOURCE_DIR/sdk/Kconfig"

######################################################################
# Project Menu
######################################################################
menu "Elevator"

    config CHECK_FILES_CRC_ON_BOOTING
        bool "Checking files' CRC on booting time"
        default n
        help
            Checking files' CRC on booting time
        help_cht
            開啟開機時檢查檔案 CRC 值的功能。
        help_chs
            开启开机时检查档案 CRC 值的功能。

    config ITU_PATH
        string "ITU files path"
        default "itu/800x480"
        help
            ITU files path
        help_cht
            ITU檔案路徑。
        help_chs
            ITU档案路径。

    config RES_PATH
        string "Resource files path"
        default "res"
        help
            Resource files path
        help_cht
            資源檔案路徑。
        help_chs
            资源档案路径。

    config UPGRADE_GUI
        bool "Upgrade by graphics display"
        default n
        help
            Upgrade by graphics display
        help_cht
            圖形顯示更新。
        help_chs
            图形显示更新。

    config WEBSERVER_PORT
        string "Web server port"
        default "8080"
        help
            Web server port
        help_cht
            網頁伺服器埠號。
        help_chs
            网页服务器埠号。

    config UPGRADE_DATA_URL
        string "Upgrade data URL"
        default "http://192.168.1.1/elevator2/"
        help
            Upgrade data URL
        help_cht
            網路更新Data路徑。
        help_chs
            网络更新Data路径。

    config UPGRADE_FW_URL
        string "Upgrade firmware URL"
        default "ftp://192.168.1.1/elevator2/ITEPKG03.PKG"
        help
            Upgrade firmware URL
        help_cht
            網路更新F/W路徑。
        help_chs
            网络更新F/W路径。

endmenu
```

## sdk/project/risc1_code/Kconfig
```kconfig
#
# For a description of the syntax of this configuration file,
# see Documentation/kbuild/kconfig-language.txt.
#

mainmenu "Project Configuration"

config CODEC
    bool
    default n
    #select HAVE_LCD
    #select HAVE_GRAPHICS
    select HAVE_AUDIO
    #select HAVE_VIDEO

config DEF_CPU_SM32
	def_bool y

config GCC_LTO
        def_bool n

config AUDIO_ENABLE
	default n

config AUDIO_DAC_MODULE
	default "itp_dac_ite9070.c"

config AUDIO_CODEC_AACDEC
	default n

config AUDIO_CODEC_AMR
	default n

config AUDIO_CODEC_EAC3DEC
	default n

config AUDIO_CODEC_MP3DEC
	default n

config AUDIO_CODEC_WAV
	default n

config AUDIO_CODEC_WMADEC
	default n

config AUDIO_CODEC_FLACDEC
	default n

config RISC_TS_DEMUX_PLUGIN
	default n

config AUDIO_CODEC_SBC
	default n

config CMAKE_SOURCE_DIR
	string
	option env="CMAKE_SOURCE_DIR"

source "$CMAKE_SOURCE_DIR/sdk/Kconfig"
```
