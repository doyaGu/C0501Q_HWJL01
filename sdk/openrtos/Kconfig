## sdk/openrtos/Kconfig
```kconfig
#
# For a description of the syntax of this configuration file,
# see Documentation/kbuild/kconfig-language.txt.
#

menu "OpenRTOS"
        hidden if DEV_DEVELOP

config GCC_LTO
    bool "GCC LTO enable"
    depends on CPU_FA626 || CPU_RISCV
    default y if (DEV_RELEASE && (CPU_FA626 || CPU_RISCV))
    default n if DEV_DEVELOP
    help
        Link Time Optimization. Recommends disabled on develop time to save build time.
        Enabled on release time to reduce ROM image size.

    help_cht
        開啟 GCC LTO (Link time optimization)。Linking 的時間會較久，但執行碼會較小，也較有效率。

    help_chs
        开启 GCC LTO (Link time optimization)。Linking 的时间会较久，但执行码会较小，也较有效率。

config OPENRTOS_HEAP_SIZE
    string "The size of individual heap size"
    default "0"
    help
        The size of individual heap size. 0 indicates to use global heap management.
    help_cht
        單獨切給作業系統使用的記憶體大小， 0表示不切割。
    help_chs
        单独切给作业系统使用的记忆体大小， 0表示不切割。

config MMAP_SIZE
    string "The size of memory mapping"
    default "0x420000" if OPENVG_ENABLE
    default "0"
    help
        The size of memory mapping. RD internal use only.
    help_cht
        指定另一塊獨立空間的記憶體大小供 nedmalloc 使用。當程式需要獨立切出記憶體使用時使用，例如 OpenVG。
    help_chs
        指定另一块独立空间的记忆体大小供 nedmalloc 使用。当程式需要独立切出记忆体使用时使用，例如 OpenVG。

endmenu
```

## sdk/project/alt_cpu_it9850/Kconfig
```kconfig
#
# For a description of the syntax of this configuration file,
# see Documentation/kbuild/kconfig-language.txt.
#

mainmenu "Project Configuration"

config ALT_CPU_ENABLE
    bool
    default y

config DEF_CPU_SM32
	def_bool y

config CMAKE_SOURCE_DIR
	string
	option env="CMAKE_SOURCE_DIR"

source "$CMAKE_SOURCE_DIR/sdk/Kconfig"
```

## sdk/project/bootloader/Kconfig
```kconfig
#
# For a description of the syntax of this configuration file,
# see Documentation/kbuild/kconfig-language.txt.
#

mainmenu "Project Configuration"

config BOOTLOADER
    bool
    default y
    select HAVE_LCD
    select HAVE_GRAPHICS
    select HAVE_AUDIO
    #select HAVE_VIDEO

config CMAKE_SOURCE_DIR
	string
	option env="CMAKE_SOURCE_DIR"

config DEF_CHIP_PKG_IT9079
    def_bool y

config RAM_INIT_SCRIPT
    default "IT9079A1_Initial_DDR2_Mem_tiling_pitch2048_360MHZ.scr"

config DCPS_ENABLE
	def_bool y

config BACKLIGHT_DUTY_CYCLES
    default "95, 92, 88, 82, 75, 65, 55, 40, 25, 5"

config BACKLIGHT_DEFAULT_DUTY_CYCLE
    default "5"

config LCD_HEIGHT
    default "480"

config LCD_INIT_SCRIPT
    default "IT9850_LCD_800_480_innolux_7inch_888.txt.in"

config NOR_CACHE_FLUSH_INTERVAL
	default "0"

config NOR_ENABLE
	def_bool y

config NOR_CACHE_SIZE
    default "0x80000"

config SD0_ENABLE
	def_bool y

config USB0_ENABLE
    def_bool y

config MSC_ENABLE
    def_bool y

config FS_FAT
	def_bool y

config I2C0_ENABLE
    default y

config UART1_ENABLE
	def_bool y

config KEYPAD_ENABLE
    def_bool y

config KEYPAD_MODULE
    default "itp_keypad_it7236.c"

config KEYPAD_REPEAT
    def_bool y

config GPIO_UART1_TX
    default "5"

config GPIO_UART1_RX
    default "-1"

config GPIO_KEYPAD
    default "23"

config TOUCH_KEY_USE_I2C
    def_bool y
    
config GPIO_ETHERNET_LINK
    default "44"

config GPIO_ETHERNET
    default "34, 35, 36, 37, 38, 39, 40, 41, 42, 43"

config TASK_DRIVE_PROBE
    def_bool y

config UPGRADE_IMAGE
    def_bool y

config UPGRADE_OPEN_FILE
    def_bool y

config DEF_DBG_UART1
    def_bool y

config DBG_INIT_SCRIPT
    default "IT9079A1_Initial_DDR2_Mem_tiling_pitch2048_320MHZ.txt"

config BUILD_UPGRADE
	def_bool y

source "$CMAKE_SOURCE_DIR/sdk/Kconfig"

menu "BootLoader"

config BL_ERR
	bool "Error Log"
	default y
	help
		Output error log

config BL_WARN
	bool "Warning Log"
	default y
	help
		Output warning log

config BL_INFO
	bool "Information Log"
	default y
	help
		Output information log

config BL_DBG
	bool "Debug Log"
	default n
	help
		Output debug log

config BL_LCD_CONSOLE
	bool "Shows console to LCD"
	depends on LCD_ENABLE && !LCD_MULTIPLE
	default n
	help
		Shows console logs to LCD on upgrading mode.

endmenu
```

## sdk/project/bootloader/Kconfig.win32
```kconfig
#
# For a description of the syntax of this configuration file,
# see Documentation/kbuild/kconfig-language.txt.
#

mainmenu "Project Configuration"

config BOOTLOADER
    bool
    default y
    select HAVE_LCD
    select HAVE_GRAPHICS
    select HAVE_AUDIO
    #select HAVE_VIDEO

config CMAKE_SOURCE_DIR
	string
	option env="CMAKE_SOURCE_DIR"

config DCPS_ENABLE
	def_bool y

config NOR_CACHE_FLUSH_INTERVAL
	default "0"

config NOR_ENABLE
	def_bool y

config SD0_ENABLE
	def_bool y

config FS_FAT
	def_bool y

config UART1_ENABLE
	def_bool y

config KEYPAD_ENABLE
    def_bool y

config KEYPAD_REPEAT
    def_bool y

config UPGRADE_IMAGE
    def_bool y

config BUILD_UPGRADE
	def_bool y

source "$CMAKE_SOURCE_DIR/sdk/Kconfig"

menu "BootLoader"

config BL_ERR
	bool "Error Log"
	default y
	help
		Output error log

config BL_WARN
	bool "Warning Log"
	default y
	help
		Output warning log

config BL_INFO
	bool "Information Log"
	default y
	help
		Output information log

config BL_DBG
	bool "Debug Log"
	default n
	help
		Output debug log

config BL_LCD_CONSOLE
	bool "Shows console to LCD"
	depends on LCD_ENABLE && !LCD_MULTIPLE
	default n
	help
		Shows console logs to LCD on upgrading mode.

endmenu
```

## sdk/project/codec_ex/Kconfig
```kconfig
#
# For a description of the syntax of this configuration file,
# see Documentation/kbuild/kconfig-language.txt.
#

mainmenu "Project Configuration"

config CODEC_EX
    bool
    default y
    #select HAVE_LCD
    #select HAVE_GRAPHICS
    select HAVE_AUDIO
    #select HAVE_VIDEO

config DEF_CPU_SM32
	def_bool y

config AUDIO_ENABLE
	default y

config AUDIO_DAC_MODULE
	default "ite9070"

config AUDIO_CODEC_AACDEC
	default y

config AUDIO_CODEC_AMR
	default y

config AUDIO_CODEC_EAC3DEC
	default y

config AUDIO_CODEC_MP3DEC
	default y

config AUDIO_CODEC_WAV
	default y

config AUDIO_CODEC_WMADEC
	default y

config AUDIO_CODEC_FLACDEC
	default y

config RISC_TS_DEMUX_PLUGIN
	default y

config AUDIO_CODEC_SBC
	default y

config CMAKE_SOURCE_DIR
	string
	option env="CMAKE_SOURCE_DIR"

source "$CMAKE_SOURCE_DIR/sdk/Kconfig"
```

## sdk/project/ctrlboard/Kconfig.win32
```kconfig
#
# For a description of the syntax of this configuration file,
# see Documentation/kbuild/kconfig-language.txt.
#

mainmenu "Project Configuration"

config CTRLBOARD
    bool
    default y
    select HAVE_LCD
    select HAVE_GRAPHICS
    select HAVE_AUDIO

config CMAKE_SOURCE_DIR
	string
	option env="CMAKE_SOURCE_DIR"

config RAM_SIZE
    default "0x4000000"

config RAM_INIT_SCRIPT
    default "IT9079A1_Initial_DDR2_Mem_tiling_pitch2048_360MHZ.scr"

config WATCHDOG_ENABLE
    def_bool y

config FONT_FILENAME
    default "wqyMicroHeiProportional.ttf"

config BACKLIGHT_ENABLE
    def_bool y

config BACKLIGHT_DUTY_CYCLES
    default "95, 92, 88, 82, 75, 65, 55, 40, 25, 5"

config BACKLIGHT_DEFAULT_DUTY_CYCLE
    default "5"

config LCD_ENABLE
    def_bool y

if !LCD_MULTIPLE

config LCD_WIDTH
    default "480"

config LCD_HEIGHT
    default "272"

config LCD_PITCH
    default "960"

config LCD_INIT_SCRIPT
    default "IT9850_LCD_800_480_innolux_7inch_888.txt.in"

endif

config CMDQ_ENABLE
    def_bool y

config AUDIO_ENABLE
    def_bool y

config SD0_ENABLE
    def_bool y

config FS_FAT
    def_bool y

config I2C0_ENABLE
    def_bool y

config I2S_ENABLE
    def_bool y

config I2S_SPDIF_ENABLE
    def_bool n

config UART1_ENABLE
    def_bool y

config TOUCH_ENABLE
    def_bool y

config DEF_IIC0_GPIO_CONFIG_2
    def_bool y

config NET_ENABLE
    def_bool n

config DEF_DBG_UART1
    def_bool y

config DBG_INIT_SCRIPT
    default "IT9079A1_Initial_DDR2_Mem_tiling_pitch2048_320MHZ.txt"

config DEF_BUILD_DEBUG
    def_bool y

config SYSTEM_NAME
    default "ITE Display Control Board"

config WIN32_SIMULATOR
    def_bool y

config FFMPEG_ENC
    def_bool y

config FFMPEG_H264_SW
    def_bool y

config ITU_FT_CACHE_ENABLE
    def_bool y

config ITU_UCL_ENABLE
    def_bool y

config BUILD_AUDIO_MGR
    def_bool y

config BUILD_INIPARSER
    def_bool y

config BUILD_ITU
    def_bool y

config BUILD_SDL
    def_bool y

config BUILD_UPGRADE
    def_bool y

config BUILD_PYINPUT
    def_bool y

if NET_ENABLE

config NET_ETHERNET
    def_bool y

config NET_HTTP
    def_bool y

config BUILD_MICROHTTPD
    def_bool y

config BUILD_XML2
    def_bool y

endif    

source "$CMAKE_SOURCE_DIR/sdk/Kconfig"

######################################################################
# Project Menu
######################################################################
menu "Display Control Board"

    config CHECK_FILES_CRC_ON_BOOTING
        bool "Checking files' CRC on booting time"
        default n
        help
            Checking files' CRC on booting time
        help_cht
            開啟開機時檢查檔案 CRC 值的功能。
        help_chs
            开启开机时检查档案 CRC 值的功能。

    config HW_VERSION
        string "Hardware version"
        default "V2"
        help
            Hardware version
        help_cht
            硬體版號。
        help_chs
            硬件版号。

    config SCREENSHOT_ENABLE
        bool "Screenshot is enabled or not"
        default n
        help
            Screenshot is enabled or not
        help_cht
            開啟螢幕擷取功能。
        help_chs
            开启屏幕撷取功能。

    config WEBSERVER_PORT
        string "Web server port"
        default "80"
        help
            Web server port
        help_cht
            網頁伺服器埠號。
        help_chs
            网页服务器埠号。

    config ITU_PATH
        string "ITU files path"
        depends on !LCD_MULTIPLE
        default "itu/480x272"
        help
            ITU files path
        help_cht
            ITU檔案路徑。
        help_chs
            ITU档案路径。

    config UPGRADE_FTP_URL
        string "Upgrade ftp URL"
        default "ftp://192.168.1.1/ctrlboard/ITEPKG03.PKG"
        help
            Upgrade ftp URL
        help_cht
            網路更新F/W路徑。
        help_chs
            网络更新F/W路径。

    config UPGRADE_GUI
        bool "Upgrade by graphics display"
        depends on !LCD_MULTIPLE
        default n
        help
            Upgrade by graphics display
        help_cht
            圖形顯示更新。
        help_chs
            图形显示更新。
            
endmenu
```

## sdk/project/dynamic_ui/Kconfig.9070
```kconfig
#
# For a description of the syntax of this configuration file,
# see Documentation/kbuild/kconfig-language.txt.
#

mainmenu "Project Configuration"

config DYNAMIC_UI
    bool
    default y
    select HAVE_LCD
    select HAVE_GRAPHICS

config CMAKE_SOURCE_DIR
	string
	option env="CMAKE_SOURCE_DIR"

config DEF_CHIP_PKG_IT9079
    def_bool y

config RAM_INIT_SCRIPT
    default "IT9079A1_Initial_DDR2_Mem_tiling_pitch2048_360MHZ.scr"

config DCPS_ENABLE
    def_bool y

config FONT_FILENAME
    default "DroidSansMono.ttf"

config BACKLIGHT_ENABLE
    def_bool y

config BACKLIGHT_DUTY_CYCLES
    default "95, 92, 88, 82, 75, 65, 55, 40, 25, 5"

config BACKLIGHT_DEFAULT_DUTY_CYCLE
    default "5"

config LCD_ENABLE
    def_bool y

config LCD_HEIGHT
    default "480"

config LCD_INIT_SCRIPT
    default "lcd_800_480_innolux_7inch_888.txt.in"

config CMDQ_ENABLE
    def_bool y

config M2D_ENABLE
    def_bool y

config KEYPAD_ENABLE
    def_bool y

config KEYPAD_MODULE
    default "itp_keypad_it7236.c"

config KEYPAD_MAPPING_TABLE
    default "keypad_doorbell_indoor.inc"

config TOUCH_KEYPAD_SET_KEY_NUMBER_ENABLE
    def_bool y

config TOUCH_KEY_NUM
    default "5"

config GPIO_KEYPAD
    default "23"

config TOUCH_KEY_USE_I2C
    def_bool y
    
config NOR_ENABLE
    def_bool y

config NOR_CACHE_SIZE
    default "0x80000"

config NOR_RESERVED_SIZE
    default "0x300000"

config NOR_PARTITION0
    def_bool y

config NOR_PARTITION0_SIZE
    default "0x0"

config USB0_ENABLE
    def_bool y

config MSC_ENABLE
    def_bool y

config FS_FAT
    def_bool y

config RTC_ENABLE
    def_bool y

config I2C0_ENABLE
    default y

config TOUCH_ENABLE
    def_bool y

config TOUCH_MODULE
    default "it7260"

config TOUCH_X_MAX_VALUE
    default "0x31F"

config TOUCH_Y_MAX_VALUE
    default "0x1DF"

config GPIO_TOUCH_INT
    default "13"

config GPIO_TOUCH_WAKE
    default "-1"

config UART1_ENABLE
    def_bool y

config GPIO_UART1_TX
    default "5"

config GPIO_UART1_RX
    default "-1"

config TASK_DRIVE_PROBE
    def_bool y

config DEF_DBG_UART1
    def_bool y

config DBG_INIT_SCRIPT
    default "IT9079A1_Initial_DDR2_Mem_tiling_pitch2048_320MHZ.txt"

config ITU_FT_CACHE_ENABLE
    def_bool y

config BUILD_INIPARSER
    def_bool y

config BUILD_ITU
    def_bool y

config BUILD_SDL
    def_bool y

config BUILD_UPGRADE
    def_bool y

######################################################################
# Start of bootloader setting
######################################################################
config BOOTLOADER_ENABLE
    def_bool n

if BOOTLOADER_ENABLE && LCD_ENABLE

config LCD_INIT_ON_BOOTING 
    def_bool y


config LCD_BOOT_BITMAP
    default "logo.bmp"

endif

if BOOTLOADER_ENABLE

config UPGRADE_BOOTLOADER
    def_bool y

config UPGRADE_IMAGE
    def_bool y

config UPGRADE_IMAGE_POS
    default "0x80000"

config UPGRADE_DATA
    def_bool y

config UPGRADE_OPEN_FILE
    def_bool y

config UPGRADE_PARTITION
    def_bool y

config UPGRADE_DELETE_PKGFILE_AFTER_FINISH
    def_bool y

config UPGRADE_NOR_IMAGE
    def_bool y

config UPGRADE_NOR_IMAGE_SIZE
    default "0x1000000"

config BL_LCD_CONSOLE
    def_bool y

config BL_ERR
    def_bool y

config BL_WARN
    def_bool y

config BL_INFO
    def_bool y

config BL_DBG
    def_bool y

endif
######################################################################
# End of bootloader setting
######################################################################

source "$CMAKE_SOURCE_DIR/sdk/Kconfig"
```

## sdk/project/dynamic_ui/Kconfig.win32
```kconfig
#
# For a description of the syntax of this configuration file,
# see Documentation/kbuild/kconfig-language.txt.
#

mainmenu "Project Configuration"

config DYNAMIC_UI
    bool
    default y
    select HAVE_LCD
    select HAVE_GRAPHICS
    select HAVE_AUDIO
    select HAVE_VIDEO

config CMAKE_SOURCE_DIR
	string
	option env="CMAKE_SOURCE_DIR"

config FONT_FILENAME
    default "DroidSansMono.ttf"    
    
config LCD_ENABLE
    def_bool y

config ITU_UCL_ENABLE
    def_bool y

config WIN32_SIMULATOR
    def_bool y

config BUILD_INIPARSER
    def_bool y

config BUILD_ITU
    def_bool y

config BUILD_SDL
    def_bool y

source "$CMAKE_SOURCE_DIR/sdk/Kconfig"
```
